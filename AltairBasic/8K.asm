;
; Page 1
;

;
;
;  SYSTEM INTERFACE
;
;	file	'8k Basic'

BASIC:				; FULL RESTART INITIALIZATION
SYSINITJ:
	JP	INITIALZ
REENTERBASIC:
				; REENTER AFTER PAUSE
	JP	CMNDRSTR

;
;  Monitor Routines
;
;co	equ	406h	;c -> screen
;cinb	equ	409h	;keyboard -> ac, carry set if any
;dclr	equ	538h	;clear screen
;xco	equ	4f4h	;c -> printer (blocking)

;
; I don't know which monitor was used here. So instead the i/o functions
; are added for the Altair 88-SIO2.
;
; July 2014, Udo Munk
;

CO:	IN	A,(10H)		; Read console status
	AND	2		; If not ready
	JP	Z,CO		; Keep waiting
	LD	A,C		; Get character
	OUT	(11H),A		; And print it
	RET

CINB:	IN	A,(10H)		; Read console status
	AND	1		; Check if character available
	RET	Z		; Return if not with carry clear
	IN	A,(11H)		; Get character
	SCF			; And set carry flag
	RET

DCLR:				; Not implemented yet
	RET

XCO:				; Not implemented yet
	RET

;
;  NON-BLOCKING INPUT
;   CHAR IN AC IF NOT ZERO
;   ZERO SET IF NONE
;
SYSKEYIN:
	PUSH	BC
	PUSH	DE
	PUSH	HL
	CALL	CINB		; Get char
	JP	NC,SYSKEYNONE
	CP	0
	JP	Z,CLEARSCREEN
	CP	1FH		; Us to bring to 14
	JP	Z,GOMONITOR
SYSKEYINRET:
	POP	HL
	POP	DE
	POP	BC
	RET
SYSKEYNONE:
	SUB	A		; Set zero
	JP	SYSKEYINRET
CLEARSCREEN:
	CALL	DCLR		; Clear screen
	JP	SYSKEYNONE
GOMONITOR:
	RST	8*1		; About using us (^_)
	NOP
	NOP
;
;  SEND AC TO SCREEN
;
SYSDISPL:
	PUSH	AF
	PUSH	BC
	PUSH	DE

;
; Page 2
;

	PUSH	HL
	LD	C,A
	CALL	CO		; C to screen
	LD	A,(P3010)	; Print on the 3010 if zero
	AND	A
	CALL	Z,XCO		; Yes print
	POP	HL
	POP	DE
	POP	BC
	POP	AF
	RET
;
;  CHECK FOR BREAK REQUEST
;   SET ZERO TO BREAK
;
SYSBREAK:
	CALL	SYSKEYIN
	JP	Z,NOBREAK
	SUB	A
	RET
NOBREAK:
	LD	A,1
	OR	A
	RET
;
;  DELAY
;
SYSWAIT:
	RET
;
;  RETURN TO MONITOR
;
MONITOR EQU	0B400H
SYSQUIT:
	JP	MONITOR

;
;  Page 3
;

CR	EQU	0DH
LF	EQU	0AH
BEL	EQU	07H
BS	EQU	08H
TAB	EQU	09H
HT	EQU	09H
CD1	EQU	11H
DEL	EQU	7FH
SI	EQU	0FH
ETX	EQU	03H
FF	EQU	0CH
ESC	EQU	18H

;
;  Page 4
;

KEYSTM	EQU	80H		; STATEMENT CODES
KEYDAT	EQU	KEYSTM
KEYREM	EQU	KEYDAT+1
KEYLSAL EQU	KEYREM+1
KEYEND	EQU	KEYLSAL
KEYFOR	EQU	KEYEND+1
KEYNEX	EQU	KEYFOR+1
KEYINPT EQU	KEYNEX+1
KEYDIM	EQU	KEYINPT+1
KEYREA	EQU	KEYDIM+1
KEYLET	EQU	KEYREA+1
KEYGTO	EQU	KEYLET+1
KEYRUN	EQU	KEYGTO+1
KEYIF	EQU	KEYRUN+1
KEYELS	EQU	KEYIF+1
KEYRES	EQU	KEYELS+1
KEYGSB	EQU	KEYRES+1
KEYRET	EQU	KEYGSB+1
KEYSTOP EQU	KEYRET+1
KEYON	EQU	KEYSTOP+1
KEYAUT	EQU	KEYON+1
KEYDEL	EQU	KEYAUT+1
KEYPLT	EQU	KEYDEL+1
KEYWAI	EQU	KEYPLT+1
KEYPRT	EQU	KEYWAI+1
KEYDEF	EQU	KEYPRT+1
KEYCON	EQU	KEYDEF+1
KEYLIS	EQU	KEYCON+1
KEYEDI	EQU	KEYLIS+1
KEYCLR	EQU	KEYEDI+1
KEYCLD	EQU	KEYCLR+1
KEYCSV	EQU	KEYCLD+1
KEYNEW	EQU	KEYCSV+1
KEYSET	EQU	KEYNEW+1
KEYSUGR EQU	KEYSET+1
KEYLSBL EQU	KEYSUGR
KEYTHEN EQU	KEYSUGR
KEYTO	EQU	KEYTHEN+1
KEYSTEP EQU	KEYTO+1
KEYLSBH EQU	KEYSTEP+1
KEYPRM	EQU	KEYLSBH
KEYLINE EQU	KEYPRM+1
KEYLSAH EQU	KEYLINE+1
KEYTAB	EQU	KEYLSAH
KEYSPC	EQU	KEYTAB+1
KEYFN	EQU	KEYSPC+1
KEYNOT	EQU	KEYFN+1
KEYOFF	EQU	KEYNOT+1
;
KEYOPR	EQU	KEYOFF+1	; OPERATOR CODES
KEYADD	EQU	KEYOPR
KEYSUB	EQU	KEYADD+1
KEYMUL	EQU	KEYSUB+1
KEYDIV	EQU	KEYMUL+1
KEYMOD	EQU	KEYDIV+1
KEYEXPT EQU	KEYMOD+1

;
;  Page 5
;

KEYAND	EQU	KEYEXPT+1
KEYOR	EQU	KEYAND+1
KEYMAX	EQU	KEYOR+1
KEYMIN	EQU	KEYMAX+1
;
KEYREL	EQU	KEYMIN+1	; RELATION CODES
KEYGT	EQU	KEYREL
KEYEQ	EQU	KEYGT+1
KEYLT	EQU	KEYEQ+1
;
KEYFCT	EQU	KEYLT+1		; FUNCTION CODES
KEYSGN	EQU	KEYFCT
KEYINT	EQU	KEYSGN+1
KEYABS	EQU	KEYINT+1
KEYSQR	EQU	KEYABS+1
KEYRND	EQU	KEYSQR+1
KEYLOG	EQU	KEYRND+1
KEYEXP	EQU	KEYLOG+1
KEYCOS	EQU	KEYEXP+1
KEYSIN	EQU	KEYCOS+1
KEYTAN	EQU	KEYSIN+1
KEYATA	EQU	KEYTAN+1
KEYUSR	EQU	KEYATA+1
KEYFRE	EQU	KEYUSR+1
KEYPORT EQU	KEYFRE+1
KEYPOS	EQU	KEYPORT+1
KEYMEM	EQU	KEYPOS+1
KEYLEN	EQU	KEYMEM+1
KEYSTR	EQU	KEYLEN+1
KEYVAL	EQU	KEYSTR+1
KEYASC	EQU	KEYVAL+1
KEYCHR	EQU	KEYASC+1
KEYHEX	EQU	KEYCHR+1
KEYHXV	EQU	KEYHEX+1
KEYUPR	EQU	KEYHXV+1
KEYLFT	EQU	KEYUPR+1
KEYRIG	EQU	KEYLFT+1
KEYMID	EQU	KEYRIG+1
KEYINS	EQU	KEYMID+1
;
KEYS	EQU	KEYINS+1	; LAST ENTRY

;
;  Page 6
;

STMTABL:			; STATEMENT ROUTINES
	DEFW	DATSTM
	DEFW	REMSTM
				; LISTED WITH BLANK AFTER
	DEFW	ENDSTM
	DEFW	FORSTM
	DEFW	NEXSTM
	DEFW	INPSTM
	DEFW	DIMSTM
	DEFW	REASTM
	DEFW	LETSTM
	DEFW	GTOSTM
	DEFW	RUNSTM
	DEFW	IFSTM
	DEFW	ELSSTM
	DEFW	RESSTM
	DEFW	GSBSTM
	DEFW	RETSTM
	DEFW	STPSTM
	DEFW	ONSTM
	DEFW	AUTSTM
	DEFW	DELSTM
	DEFW	PLTSTM
	DEFW	WAISTM
	DEFW	PRTSTM
	DEFW	DEFSTM
	DEFW	CONSTM
	DEFW	LISSTM
	DEFW	EDISTM
	DEFW	CLRSTM
	DEFW	CLDSTM
	DEFW	CSVSTM
	DEFW	NEWSTM
	DEFW	SETSTM

;
;  Page 7
;

OPRTABL:			; OPERATORS AND PRECEDENCE
	DEFB	79H
	DEFW	ADDOPR
	DEFB	79H
	DEFW	SUBOPR
	DEFB	7BH
	DEFW	MULOPR
	DEFB	7BH
	DEFW	DIVOPR
	DEFB	7BH
	DEFW	MODOPR
	DEFB	7FH
	DEFW	EXPOPR
	DEFB	50H
	DEFW	ANDOPR
	DEFB	46H
	DEFW	ORNOPR
	DEFB	76H
	DEFW	MAXOPR
	DEFB	76H
	DEFW	MINOPR

;
;  Page 8
;

FCTTABL:			; FUNCTION ROUTINES
	DEFW	SGNFCT
	DEFW	INTFCT
	DEFW	ABSFCT
	DEFW	SQRFCT
	DEFW	RNDFCT
	DEFW	LOGFCT
	DEFW	EXPFCT
	DEFW	COSFCT
	DEFW	SINFCT
	DEFW	TANFCT
	DEFW	ATNFCT
	DEFW	ERRAFC
	DEFW	FREFCT
	DEFW	PORFCT
	DEFW	POSFCT
	DEFW	MEMFCT
	DEFW	LENFCT
	DEFW	STRFCT
	DEFW	VALFCT
	DEFW	ASCFCT
	DEFW	CHRFCT
	DEFW	HEXFCT
	DEFW	HXVFCT
	DEFW	UPRFCT
	DEFW	LFTFCT
	DEFW	RIGFCT
	DEFW	MIDFCT
	DEFW	INSFCT

;
;  Page 9
;

KEYWADDS:
				; POINTERS TO KEYWORD GROUPS
	DEFW	KEYWRD0, KEYWRD1, KEYWRD2, KEYWRD3
	DEFW	KEYWRD4, KEYWRD5, KEYWRD6, KEYWRD7
	DEFW	KEYWRD8, KEYWRD9, KEYWRDA, KEYWRDB
	DEFW	KEYWRDC, KEYWRDD, KEYWRDE, KEYWRDF
KEYWORDS:
KEYWRD0:
	DEFB	KEYPLT, 'PLO', 'T'+128
	DEFB	KEYPRT, 'PRIN', 'T'+128
	DEFB	KEYPRM, 'PROMP', 'T'+128
	DEFB	KEYPORT, 'POR', 'T'+128
	DEFB	KEYPOS-80H, 'PO', 'S'+128
KEYWRD1:
	DEFB	KEYAUT, 'AUT', 'O'+128
	DEFB	KEYAND, 'AN', 'D'+128
	DEFB	KEYABS, 'AB', 'S'+128
	DEFB	KEYATA, 'AT', 'N'+128
	DEFB	KEYASC-80H, 'AS', 'C'+128
KEYWRD2:
	DEFB	KEYREM, 'RE', 'M'+128
	DEFB	KEYREA, 'REA', 'D'+128
	DEFB	KEYRUN, 'RU', 'N'+128
	DEFB	KEYRES, 'RESTOR', 'E'+128
	DEFB	KEYRET, 'RETUR', 'N'+128
	DEFB	KEYRND, 'RN', 'D'+128
	DEFB	KEYRIG-80H, 'RIGHT', '$'+128
KEYWRD3:

;
;  Page 10
;

	DEFB	KEYSTOP, 'STO', 'P'+128
	DEFB	KEYCON, 'CON', 'T'+128
	DEFB	KEYCLR, 'CLEA', 'R'+128
	DEFB	KEYCSV, 'SAV', 'E'+128
	DEFB	KEYSET, 'SE', 'T'+128
	DEFB	KEYSTEP, 'STE', 'P'+128
	DEFB	KEYSPC, 'SP', 'C'+128
	DEFB	KEYSGN, 'SG', 'N'+128
	DEFB	KEYSQR, 'SQ', 'R'+128
	DEFB	KEYCOS, 'CO', 'S'+128
	DEFB	KEYSIN, 'SI', 'N'+128
	DEFB	KEYSTR, 'STR', '$'+128
	DEFB	KEYCHR-80H, 'CHR', '$'+128
KEYWRD4:
	DEFB	KEYDAT, 'DAT', 'A'+128
	DEFB	KEYDIM, 'DI', 'M'+128
	DEFB	KEYDEL, 'DELET', 'E'+128
	DEFB	KEYDEF, 'DE', 'F'+128
	DEFB	KEYTHEN, 'THE', 'N'+128
	DEFB	KEYTO, 'T', 'O'+128
	DEFB	KEYTAB, 'TA', 'B'+128
	DEFB	KEYTAN-80H, 'TA', 'N'+128
KEYWRD5:
	DEFB	KEYEND, 'EN', 'D'+128
	DEFB	KEYELS, 'ELS', 'E'+128
	DEFB	KEYEDI, 'EDI', 'T'+128
	DEFB	KEYEXP, 'EX', 'P'+128
	DEFB	KEYUSR, 'US', 'R'+128
	DEFB	KEYUPR-80H, 'UPPER', '$'+128

;
;  Page 11
;

KEYWRD6:
	DEFB	KEYFOR, 'FO', 'R'+128
	DEFB	KEYFN, 'F', 'N'+128
	DEFB	KEYFRE, 'FR', 'E'+128
	DEFB	KEYVAL-80H, 'VA', 'L'+128
KEYWRD7:
	DEFB	KEYGTO, 'GOT', 'O'+128
	DEFB	KEYGSB, 'GOSU', 'B'+128
	DEFB	KEYWAI-80H, 'WAI', 'T'+128
KEYWRD8:
	DEFB	KEYHEX, 'HEX', '$'+128
	DEFB	KEYHXV-80H, 'HEX', 'V'+128
KEYWRD9:
	DEFB	KEYINPT, 'INPU', 'T'+128
	DEFB	KEYIF, 'I', 'F'+128
	DEFB	KEYINT, 'IN', 'T'+128
	DEFB	KEYINS-80H, 'INST', 'R'+128
KEYWRDA:
	DEFB	KEYMUL-80H, '*'+128
KEYWRDB:
	DEFB	KEYADD-80H, '+'+128
KEYWRDC:
	DEFB	KEYLET, 'LE', 'T'+128
	DEFB	KEYLIS, 'LIS', 'T'+128
	DEFB	KEYCLD, 'LOA', 'D'+128
	DEFB	KEYLINE, 'LIN', 'E'+128
	DEFB	KEYLT, '<'+128
	DEFB	KEYLOG, 'LO', 'G'+128
	DEFB	KEYLEN, 'LE', 'N'+128
	DEFB	KEYLFT-80H, 'LEFT', '$'+128
KEYWRDD:
	DEFB	KEYSUB, '-'+128
	DEFB	KEYMOD, 'MO', 'D'+128
	DEFB	KEYMAX, 'MA', 'X'+128
	DEFB	KEYMIN, 'MI', 'N'+128

;
;  Page 12
;

	DEFB	KEYEQ, '='+128
	DEFB	KEYMEM, 'ME', 'M'+128
	DEFB	KEYMID-80H, 'MID', '$'+128
KEYWRDE:
	DEFB	KEYNEX, 'NEX','T'+128
	DEFB	KEYNEW, 'NE','W'+128
	DEFB	KEYNOT, 'NO','T'+128
	DEFB	KEYEXPT, '^'+128
	DEFB	KEYGT-80H, '>'+128
KEYWRDF:
	DEFB	KEYPRT, '?'+128
	DEFB	KEYON, 'O', 'N'+128
	DEFB	KEYOFF, 'OF', 'F'+128
	DEFB	KEYDIV, '/'+128
	DEFB	KEYOR-80H, 'O', 'R'+128

;
;  Page 13

ERRN:				; ERROR CODES
ERRNCN:
	DEFB	'CONTINUE',0	; CONTINUE ERROR
ERRNSL:
	DEFB	'DEVICE',0	; SAVE/LOAD DEVICE ERROR
ERRNDD:
	DEFB	'DIMENSION',0	; DOUBLE DIMENSION
ERRNID:
	DEFB	'DIRECT',0	; ILLEGAL DIRECT
ERRND0:
	DEFB	'DIVIDE BY 0',0	; DIVISION BY ZERO
ERRNFC:
	DEFB	'FUNCTION CALL',0 ; FUNCTION CALL
ERRNLS:
	DEFB	'LONG STRING',0	; LONG STRING
ERRNOM:
	DEFB	'MEMORY SPACE',0 ; OUT OF MEMORY
ERRNNF:
	DEFB	'NEXT W/O FOR',0 ; NEXT WITHOUT FOR
ERRNOD:
	DEFB	'OUT OF DATA',0	; OUT OF DATA
ERRNOV:
	DEFB	'OVERFLOW',0	; OVERFLOW
ERRNRG:

;
;  Page 14
;

	DEFB	'RETN W/O GOSUB',0 ; RETURN WITHOUT GOSUB
ERRNOS:
	DEFB	'STRING SPACE',0 ; OUT OF STRING SPACE
ERRNST:
	DEFB	'STRING TEMPS',0 ; STRING TEMPORARIES
ERRNBS:
	DEFB	'SUBSCRIPT',0	; BAD SUBSCRIPT
ERRNSN:
	DEFB	'SYNTAX',0	; SYNTAX ERROR
ERRNTM:
	DEFB	'TYPE',0	; TYPE MISMATCH
ERRNUF:
	DEFB	'UNDFND FUNCTION',0 ; UNDEFINED FUNCTION
ERRNUS:
	DEFB	'UNDFND LINE',0	; UNDEFINED STATEMENT
ERRNUV:
	DEFB	'UNDFND VARIABLE',0 ; UNDEFINED VARIABLE
ERRNFI:
	DEFB	'File not Saved',0 ; Unknown file name

;
;  Page 15
;

;
;  INTERPRETER VARIABLES
;
;            VARIABLES MARKED WITH SAME CHARACTER IN COLUMN 71
;               ARE FIXED IN THAT ORDER.
;


P3010:	DEFB	1		; 0 to print on 3010	
REAINPFL:
	DEFB	0		; READ/INPUT FLAG	
PRINTFLG:
	DEFB	0		; PRINT/NO PRINT FLAG	
TRACEFLG:
	DEFB	1		; TRACE/NO TRACE FLAG
SCANPFLG:
	DEFB	0		; SCAN/NOSCAN PARENTHESIS FLAG
SCANPFLE:
	DEFB	1		; ARRAY NAME FOR ERASE
SCANPFLD EQU	KEYS-'('	; NO ARRAY ELEMENTS WANTED
MATSCCNT:
	DEFB	0		; SUBSCRIPT COUNT
MATDMFLG:
	DEFB	0		; SCANNING FOR VAR/DIMENSION V
TYPEFLG:DEFB	0		; TYPE FLAG                  V
TYPEINTG EQU	2		; TYPE OF INTEGER
TYPESTRG EQU	3		; TYPE OF STRING
TYPESING EQU	4		; TYPE OF SINGLE FLOATING POINT
TYPEDUBL EQU	8		; TYPE OF DOUBLE FLOATING POINT
TYPEDEF EQU	080H/4		; MARKING BIT FOR USER-FUNCTION


STRGTMPL:
	DEFB	0		; TEMP STRING DESCRIPTR, LEN  S
STRGTMPA:
	DEFW	0		; TEMP STRING DESCRIPTR, ADDR S
SCANPTR1:
	DEFW	0		; SCAN POINTER
SCANPTR2:
	DEFW	0		; SCAN POINTER
CURLINE:DEFW	-1		; CURRENT LINE NUMBER
CURLINES:
	DEFW	0		; SAVED CURRENT LINE NUMBER
PROGCNTR:
	DEFW	ENDINTRP+12	; CURRENT PROGRAM LOCATION
VARINDEX EQU	PROGCNTR	; INDEX VARIABLE OF FOR
PROGCNTS:
	DEFW	0		; SAVED CURRENT PROGRAMLOCATION
CURLDATA:
	DEFW	0		; CURRENT DATA LINE NUMBER
CURDATAP:
	DEFW	ENDINTRP	; CURRENT DATA POINTER
INPTBUFR:
	DEFW	INITSTSP	; INPUT BUFFER ADDRESS
PREDREL EQU	064H		; PRECEDENCE OF RELATION
PREDNUM EQU	070H		; LOWER BNDRY OF NUM OP PREC.
PREDNOT EQU	05AH		; PRECEDENCE OF NOT OPERATOR
PREDUMIN EQU	07DH		; PRECEDENCE OF UNARY MINUS
LINESYZE EQU	79+78		; DEFAULT LINESYZE
ITEMSIZE EQU	14		; DEFAULT WIDTH OF PRINT ITEM

;
;  Page 16
;

;
;  MEMORY ALLOCATIN POINTERS
;


;
LIMLOWER EQU	08000H
LIMUPPER EQU	0AF00H
;
;  MEMORY LAYOUT
;
;  ENCODE BUFFER
;  PROGRAM
;  VARIABLES
;  ARRAYS
;  FREE SPACE  /  STACK (INCLUDING BUFFERS)
;  FREE STRING SPACE
;  STRINGS
;  STRING TEMPORARIES
;  FREE STRING TEMPORARIES
;
PROGBASE:
	DEFW	ENDINTRP+13	; BASE OF PROGRAM SPACE
VARTABLE:
	DEFW	ENDINTRP+15	; BASE OF VARIABLE TABLE
MATTABLE:
	DEFW	ENDINTRP+15	; BASE OF ARRAY TABLE
FREELIMT:
	DEFW	ENDINTRP+15	; LOWER LIMIT OF FREE SPACE
STCKBASE:
	DEFW	INITSTCK	; BASE OF STACK
STRGFREE:
	DEFW	INITSTCK+10	; FIRST FREE STRING SPACE	
STRGBASE:
	DEFW	INITSTCK+10	; BASE OF STRING SPACE
STRGTMPP:
	DEFW	INITSTCK+11	; STRING TEMPORARY ALLOC PTR
STRGTLIM:
	DEFW	INITSTCK+10+2*3	; STRING TEMPORARY LIMIT


ACCUMLTR:
	DEFB	0,0		; ACCUMULATOR			A
FLACCMSB:
	DEFB	0		; SIGN-BIT/HIGH-ORDER MANTISSA	A
FLACCEXP:
	DEFB	0		; EXPONENT			A
FLACCSSV:
	DEFB	0		; SAVED SIGN			A

NULLCNT:DEFB	1		; # OF NULLS TO INSERT AFTER (CR)
CURSPOS:DEFB	1		; CHARACTER CURSOR POSITION	C
CURSLIM:DEFB	256-LINESYZE	; OUTPUT CURSOR LIMIT		C

FLSCR0:	DEFB	0		; FLOATING POINT SCRATCH AREA
FLSCR1:	DEFB	1
FLSCR2:	DEFB	2
FLSCR3:	DEFB	3

INOTINS EQU	FLSCR0		; INPUT/OUTPUT INSTRUCTIONS
OPCINP	EQU	0DBH		; INPUT INSTRUCTION
OPCOUT	EQU	0D3H		; OUTPUT INSTRUCTION
OPCRET	EQU	0C9H		; RETURN INSTRUCTION

RNDFCTSD:
	DEFB	052H, 0C7H, 04FH, 080H ; RANDOM SEED

;
; Page 17
;

;
;
;  GENERAL USE SUBROUTINES
;
;
;  SCAN ONE CHARACTER AND CLASSIFY
;
SCANNXTV:
	LD	A,(HL)		; SCAN CURRENT BYTE,
	EX	(SP),HL
	CP	(HL)		; VERIFY MATCH,
	INC	HL
	EX	(SP),HL
	JP	NZ,ERRASN	; SQUAWK ABOUT SYNTAX ERROR
SCANNXT:
	INC	HL		; SCAN FOR NEXT NON-BLANK CHAR
	LD	A,(HL)		; C=NUMERIC CHARACTER
	CP	':'		; Z=END OF STATEMENT
	RET	NC
	CP	' '
	JP	Z,SCANNXT
	CP	'0'
	CCF
	INC	A
	DEC	A
	RET

;
;  Page 18
;

;
;  TEST FOR ALPHABETIC CHARACTER
;
ALPHACHK:
	LD	A,(HL)		; TEST FOR ALPHABETIC CHARACTER
ALPHACHA:
	CP	'z'+1		; LOWER CASE
	RET	NC
	CP	'a'		; LOWER CASE
	JP	NC,ALPHACHL
	CP	'Z'+1		; C=ALPHABETIC
	RET	NC
	CP	'A'		; UPPER CASE
	CCF
	RET
ALPHACHL:
	ADD	A,'A'-'a'	; CONVERT LOWER TO UPPER
	RET

;
;  MATCH CHARACTER OF BUFFER AGAINST CHARACTER IN A
;
CHARMTCH:
	XOR	(HL)		; MAKE MATCH TEST
	RET	Z		; Z-SUCCESS]
	CP	'a'-'A'		; LOWER CASE - UPPER CASE
	RET	NZ		; NOT LOWER-UPPER DIFFERENCE
	CALL	ALPHACHK	; ALPHABETIC?
	SBC	A,A
	INC	A		; Z=C,S=0
	RET

;
;  CHECK TYPE OF EXPRESSION	       LEN     CHAR
;            RETURNS:  S => INTEGER	2	%
;		       Z => STRING	3	$
;		      PO => SINGLE	4	@
;		      NC => DOUBLE	8	#
TYPECHK:
	LD	A,(TYPEFLG)
TYPECHKA:
	CP	TYPESING+1
	DEC	A
	DEC	A
	DEC	A
	OR	A
	SCF
	RET

;
;  Page 19
;

;
;  SCAN A PAIR OF LINE NUMBER PARAMETERS
;
SCANLPRZ:
	LD	BC,0		; DEFAULT SECOND IS FIRST
SCANLPRM:
	CALL	NZ,SCANLINN	; DEFAULT FIRST IS IN DE
	PUSH	AF
	LD	A,B
	OR	C		; ZERO DEFAULT IS FIRST PARAMETER
	JP	NZ,SCANLPR1
	LD	B,D
	LD	C,E
SCANLPR1:
	POP	AF
	EX	DE,HL
	EX	(SP),HL		; PUT FIRST ONTO STACK
	PUSH	HL
	EX	DE,HL
	LD	D,B
	LD	E,C
	RET	Z
	CP	KEYDIV		; SEPARATOR MUST BE '/'.
	JP	Z,SCANLPR2
	CALL	SCANNXTV	; Bscan (val)
	DEFB	','		;   OR ','
	DEC	HL
SCANLPR2:
	LD	DE,0FFFFH	; EMPTY SECOND OPERAND = END
	CALL	SCANNXT		; Bscan ,
	RET	Z

;
;  SCAN A LINE NUMBER
;
SCANLINN:
	DEC	HL		; SCAN LINE # IN COMMAND/STATEMENT
SCANLINR:
	LD	DE,0		; DEFAULT LINE IS 0, INITIALIZE
SCANLINL:
	CALL	SCANNXT		; Bscan ,
	RET	NC
	PUSH	HL
	PUSH	AF
	LD	HL,0FFFFH/10-1
	CALL	CMHLLTDE
	JP	C,ERRASN
	LD	H,D
	LD	L,E		; HL=10*DE
	ADD	HL,DE
	ADD	HL,HL
	ADD	HL,DE
	ADD	HL,HL
	POP	AF
	SUB	'0'		; GET VALUE OF NEXT DIGIT

;
;  Page 20
;

	LD	E,A
	LD	D,000H
	ADD	HL,DE		; AND ADD IT ON
	EX	DE,HL
	POP	HL
	JP	SCANLINL

;
;  Page 21
;

;
;  SEARCH FOR A GIVEN LINE NUMBER
;
LINESRCH:
	LD	HL,(PROGBASE)	; LOOK FOR LINE NUMBER IN DE
LINESRCL:
	PUSH	HL		; C=LINE FOUND
	CALL	LINELINK	; BC=LINE LOCATION, IF FOUND
	JP	Z,POPHLRET	; =NEXT LINE, IF NOT FOUND
	PUSH	BC		; ADDRESS OF NEXT LINE
	LD	A,(HL)		; GET NUMBER OF CURRENT LINE
	INC	HL
	LD	H,(HL)		; (from HL,MA)
	LD	L,A
	CALL	CMHLLTDE
	POP	HL		; HL=NEXT LINE
	POP	BC
	CCF
	RET	Z
	JP	NC,LINESRCL
	LD	H,B
	LD	L,C
	CCF
	RET

;
;  LINK TO NEXT LINE
;
LINELINK:
	PUSH	HL		; FIND ADDRESS OF NEXT LINE
	LD	C,(HL)		; Z=END OF PROGRAM
	INC	HL
	LD	B,(HL)
	INC	HL
	EX	(SP),HL
	ADD	HL,BC		; ADD LENGTH TO ADDRESS
	EX	(SP),HL
	LD	A,B
	OR	C
	POP	BC
	RET

;
;  Page 22
;

;
;  INSERT/REPLACE LINE OF PROGRAM
;
LINEINS:
	PUSH	DE		; DE=LINE NUMBER
	CALL	NC,KEYSCAN	; C=ALREADY KEY-SCANNED
	CALL	SCANNXT		; Bscan , NC=MUST BE KEY-SCANNED
	POP	DE
	PUSH	HL		; HL=TEXT TO INSERT
	PUSH	DE
	PUSH	BC		; BC=LENGTH OF TEXT
	PUSH	AF		; Z=DELETE, NO REPLACE
	CALL	LINESRCH	; LOOK FOR LINE
	PUSH	BC		; SAVE LOCATION
	CALL	C,LINEDEL	; DELETE IF PRESENT
	POP	DE
	POP	AF
	JP	Z,POPHL3RT	; EXIT IF NOTHING MORE
	LD	HL,(FREELIMT)	; PULL APART FOR NEW LINE
	EX	(SP),HL
	POP	BC
	PUSH	HL
	ADD	HL,BC
	CALL	COPYCHK
	EX	DE,HL
	POP	BC
	LD	(HL),C		; BEGINNING OF NEW LINE
	INC	HL
	LD	(HL),B
	INC	HL
	POP	DE
	LD	(HL),E		; INSERT LINE NUMBER
	INC	HL
	LD	(HL),D
	INC	HL
	EX	DE,HL
	POP	HL		; RECOVER TEXT POINTER
LINEINSL:
	LD	A,(HL)		; INSERT TEXT OF NEW LINE
	LD	(DE),A
	INC	HL
	INC	DE
	OR	A
	JP	NZ,LINEINSL
	JP	LINEDELU


;
;  Page 23
;

;
;  DELETE TEXT FROM PROGRAM
;
LINEDEL:
	EX	DE,HL		; BC=BEGINNING OF TEXT TO REMOVE
	LD	A,C
	SUB	E		; COMPUTE NETATIVE OF
	LD	L,A		; NUMBER OF BYTES DELETED
	LD	A,B
	SBC	A,D
	LD	H,A
	PUSH	HL
	LD	HL,(FREELIMT)	; HL=BEGINNING OF TEXT SURVIVING
LINEDELL:
	LD	A,(DE)
	LD	(BC),A
	INC	BC
	INC	DE
	CALL	CMHLLTDE
	JP	NC,LINEDELL
	POP	BC
LINEDELU:
	LD	HL,(FREELIMT)	; UPDATE DATA POINTERS
	ADD	HL,BC		; BC=INCREMENT
	LD	(FREELIMT),HL
	LD	HL,(MATTABLE)
	ADD	HL,BC
	LD	(MATTABLE),HL
	LD	HL,(VARTABLE)
	ADD	HL,BC
	LD	(VARTABLE),HL
	JP	CLEARPCN

;
;  MAKE SIXTEEN BIT COMPARISON
;
CMHLLTDE:
	LD	A,H		; COMPARE DE VS HL
	SUB	D		; C=HL<DE
	RET	NZ
	LD	A,L
	SUB	E
	RET

;
;  Page 24
;

;
;  MOVE LONG TO HIGHER ADDRESS
;
COPYCHK:
	CALL	SPACECHK
COPYTEXT:
	PUSH	BC		; COPY SECTION DE-BC TO AREA
	EX	(SP),HL		; ENDING AT HL
	POP	BC
COPYTXTL:
	CALL	CMHLLTDE
	LD	A,(HL)
	LD	(BC),A
	RET	Z
	DEC	BC
	DEC	HL
	JP	COPYTXTL

;
;  CHECK SPACE FOR STACK ALLOCATION
;
SPACESTK:
	PUSH	HL		; VERIFY STACK HAS ROOM ENOUGH
	LD	HL,(FREELIMT)	; C=NUMBER OF WORKS NEEDED
	LD	B,000H
	ADD	HL,BC
	ADD	HL,BC
	CALL	SPACECHK
	POP	HL
	RET

;
;  CHECK SPACE FOR PROGRAM OR VARIABLE ALLOCATION
;
SPACECHK:
	PUSH	DE		; CHECK THAT ENOUGH SPACE IS LEFT
	EX	DE,HL		; ON STACK ABOVE HL
	LD	HL,-38
	ADD	HL,SP
	CALL	CMHLLTDE
	EX	DE,HL
	POP	DE
	RET	NC
ERRAOM:
	LD	E,ERRNOM-ERRN
	JP	ERRMSG

;
;  Page 25
;

;
;  RE-INITIALIZATION ROUTINES
;
NEWSTM:
	RET	NZ		; NEW COMMAND
CLEARPGM:
	LD	HL,(PROGBASE)	; CLEAR PROGRAM
	XOR	A
	LD	(HL),A
	INC	HL
	LD	(HL),A
	INC	HL
NEWLOAD:
	LD	(VARTABLE),HL
CLEARSET:
	CALL	CLEARPCN	; CLEAR PROGRAM POINTERS
CLEARVST:
	LD	(PROGCNTR),HL	; UPDATE PROGRAM COUNTER
	CALL	CLEARVAR	; CLEAR VARIABLES
CLEARSTK:
	POP	BC		; RESET STACK,
	LD	HL,(STCKBASE)
	LD	SP,HL
	LD	HL,0-LINESYZE-3
	ADD	HL,SP
	LD	SP,HL		; CREATE INPUT BUFFER
	LD	(INPTBUFR),HL
	LD	HL,(STRGBASE)	; CLEAR STRING TEMPORARIES,
	INC	HL
	LD	(STRGTMPP),HL
	LD	HL,0
	PUSH	HL
	LD	(PROGCNTS),HL	; SET NO CONTINUE
	LD	HL,(PROGCNTR)
	PUSH	BC
	RET

CLEARVAR:
	LD	HL,(VARTABLE)	; CLEAR ALL VARIABLES
	LD	(MATTABLE),HL
	LD	(FREELIMT),HL
	LD	HL,(STRGBASE)
	LD	(STRGFREE),HL
	RET

CLEARPCN:
	LD	HL,0		; CLEAR PROGRAM POINTERS
	LD	(PROGCNTS),HL
	LD	HL,(PROGBASE)
	DEC	HL
	LD	(HL),0		; END OF LINE -1
	LD	(PROGCNTR),HL
	XOR	A

;
;  Page 26
;

;
;  RESTORE:  REWIND DATA STATEMENTS
;
RESSTM:
	JP	Z,RESSTMDF	; RESTORE STATEMENT
	CALL	SCANLINN
	PUSH	HL
	CALL	LINESRCH
	JP	NC,ERRAUS
	POP	HL
	EX	DE,HL
	JP	RESSTMBU
RESSTMDF:
	EX	DE,HL		; DEFAULT IS RESTORE TO BEGINING
	LD	HL,(PROGBASE)
RESSTMBU:
	DEC	HL		; BACK UP BEFORE LINE
RESDTPTR:
	LD	(CURDATAP),HL	; SET DATA POINTER
	EX	DE,HL
	RET

;
;  CLEAR:  CLEAR VARIABLES, REALLOCATE STRING SPACE
;
CLRSTM:
	JP	Z,CLEARVST	; CLEAR STATEMENT
	CALL	VALINTDE
	DEC	HL		; Bscan -
	CALL	SCANNXT		; Bscan ,
	RET	NZ
	PUSH	HL
	LD	HL,(STRGBASE)
	LD	A,L
	SUB	E
	LD	E,A
	LD	A,H
	SBC	A,D
	LD	D,A
	JP	C,ERRASN
	LD	HL,(VARTABLE)
	LD	BC,40
	ADD	HL,BC
	CALL	CMHLLTDE
	JP	NC,ERRAOM
	EX	DE,HL
	LD	(STCKBASE),HL
	POP	HL
	JP	CLEARVST

;
;  Page 27
;

;
;  LOW-LEVEL CHARACTER I/O ROUTINES
;
PRNTCHRI:
	EX	(SP),HL
	LD	A,(HL)
	INC	HL
	EX	(SP),HL
PRNTCHRA:
	PUSH	AF		; TRANSMIT CHARACTER
	LD	A,(PRINTFLG)
	OR	A
	JP	NZ,POPAFRET
	POP	AF
	PUSH	AF
	CP	' '
	JP	C,PRNTCHRW
	PUSH	HL
	LD	HL,(CURSPOS)	; LINE TOO LONG?
	LD	A,H
	ADD	A,L
	LD	A,L
	POP	HL
	CALL	C,PRNTCRLF
	INC	A
	LD	(CURSPOS),A
PRNTCHRW:
	POP	AF		; SEND CHARACTER
	CALL	SYSDISPL
	RET

INPTCHAR:
	CALL	SYSKEYIN	; RECEIVE A CHARACTER
	JP	Z,INPTCHAR	; WAIT FOR ONE
	CP	SI
	RET	NZ
	LD	A,(PRINTFLG)
	CPL
	LD	(PRINTFLG),A
	JP	INPTCHAR

;
;  Page 28
;

;
;  ERROR PROCESSING
;
MSGERROR:
	DEFB	' ERROR',0
MSGIN:
	DEFB	' IN ',0
MSGOK:
	DEFB	CR,LF,'OK',CR,LF,0
MSGBREAK:
	DEFB	CR,LF,'BREAK',0

ERRDATA:
	LD	HL,(CURLDATA)
	LD	(CURLINE),HL
ERRASN:
	LD	E,ERRNSN-ERRN
ERRMSG:
	CALL	CLEARSTK
	XOR	A
	LD	(PRINTFLG),A	; TURN ON PRINTING
	LD	(SCANPFLG),A	; ALLOW SUBSCRIPTING
	CALL	PRNTCRLF
	LD	HL,ERRN
	LD	D,A
	CALL	PRNTCHRI	; Print (val)
	DEFB	'?'
	ADD	HL,DE		; PRINT ERROR CODE
	CALL	PRNTMSG
	LD	HL,MSGERROR
ERRMSGPR:
	CALL	PRNTMSG
	LD	HL,(CURLINE)
	LD	A,H
	AND	L
	INC	A
	CALL	NZ,ERRMSGIN

;
;  Page 29
;

;
;  COMMAND/LINE INPUT
;
CMNDSTRT:
	XOR	A		; TOP LEVEL EXECUTIVE
	LD	(PRINTFLG),A	; TURN ON PRINTING
	LD	(SCANPFLG),A	; ALLOW SUBSCRIPTINT
	LD	HL,-1
	LD	(CURLINE),HL
	LD	HL,MSGOK
	CALL	PRNTMSG		; REQUEST COMMAND
CMNDINPT:
	LD	DE,MSGSTARS+2	; INPUT COMMAND
	CALL	INPTRQST
	JP	C,CMNDINPT
	CALL	SCANNXT		; Bscan ,
	PUSH	AF
	CALL	SCANLINN	; SCAN OFF LINE NUMBER
	PUSH	DE
	CALL	KEYSCAN		; SCAN STATEMENT
	POP	DE
	POP	AF
	JP	NC,EXECUTE	; DIRECT IF NO LINE NUMBER
	CALL	LINEINS		; INSERT LINE AS REQUESTED
	JP	CMNDINPT

CMNDRSTR:
	CALL	CLEARSTK	; ENTRY FOR RESTARTING
	CALL	PRNTCRLF
	LD	HL,MSGREDO+11	; TELL HIM WE'RE STARTING
	JP	ERRMSGPR

;
;  Page 30
;

;
;  AUTOMATIC LINE-NUMBERED INPUT
;
AUTSTMIN:
	PUSH	DE		; SAVE LINE NUMBER
	CALL	LINEINS		; INSERT LINE
	POP	HL		; RECOVER LINE NUMBER,
	POP	DE		; INCREMENT
	ADD	HL,DE
	JP	C,ERRAOV
	JP	AUTSTMN
AUTSTM:
	POP	BC		; REMOVE CALLER
AUTSTMS:
	LD	DE,1000		; DEFAULT STARTING LINE NUMBER
	LD	BC,100		; DEFAULT INCREMENT VALUE
	CALL	SCANLPRM	; SCAN PARAMETERS
	JP	NZ,ERRASN
	POP	HL
	CALL	PRNTCRLF
AUTSTMN:
	PUSH	DE		; SAVE INCREMENT
	PUSH	HL		; AND NEXT LINE NUMBER
	CALL	ENCODEHL	; PROMPT WITH LINE NUMBER
	EX	DE,HL
	INC	DE
	CALL	INPTRQST
	POP	DE
	JP	C,AUTSTMBR
	CALL	SCANNXT		; Bscan ,
	JP	NC,AUTSTMIN
	CCF
AUTSTMBR:
	POP	DE		; TAKE A BREAK
	JP	C,CMNDSTRT	; END OF AUTO
	JP	AUTSTMS		; GET NEW LINE NUMBER, INCREMENT

;
;  Page 31
;

;
;  LEXICAL SCANNER / KEYWORD RECOGNITION
;
KEYSCAN:
	LD	C,5		; SCAN INPUT LINE FOR KEYWORDS,
	LD	D,H		; CONDENSE LINE ON TOP OF SELF
	LD	E,L
	DEC	HL		; Bscan -
	PUSH	HL
	CALL	SCANNXT		; Bscan +
KEYSCANL:
	LD	A,(HL)
	CP	' '
	JP	Z,KEYSCANH	; DELETE BLANKS
	LD	B,A
	CP	'"'
	JP	Z,KEYSCANI	; SWALLOW WHOLE STRING
	OR	A
	JP	Z,KEYSCANX
	CP	'0'		; NON-KEYWORD
	JP	C,KEYSCANK
	CP	'<'		;   SO WE DON'T SCAN
	JP	C,KEYSCANP
KEYSCANK:
	PUSH	BC		; SCAN FOR MATCHING KEYWORD
	PUSH	DE
	PUSH	HL
	AND	00FH		; HASH CHARACTER
	LD	E,A
	LD	D,0
	LD	HL,KEYWADDS	; ADDRESS C'SPONDING KEYWORDS
	ADD	HL,DE
	ADD	HL,DE
	LD	E,(HL)
	INC	HL
	LD	D,(HL)
	EX	DE,HL
	JP	KEYSCANB

KEYSCANZ:
	LD	A,(DE)
	OR	A
	JP	P,KEYSCANN
KEYSCANM:
	LD	A,B		; MATCH, GET SYMBOL NUMBER
	OR	080H
	JP	KEYSCANF
KEYSCANN:
	INC	HL		; ADDRESS NEXT CHAR IN LINE
	INC	DE
	INC	C
KEYSCANC:
	LD	A,(DE)		; COMPARE LINE WITH KEYWORD
	AND	07FH
	CALL	CHARMTCH	; COMPARE CHARACTERS

;
;  Page 32
;

	JP	Z,KEYSCANZ
	LD	A,C		; MATCH ENOUGH YET?
	CP	3
	JP	C,KEYSCANA

	CALL	ALPHACHK	; STOP ON BREAK CHAR OK
	DEC	HL
	JP	NC,KEYSCANM
KEYSCANA:
	EX	DE,HL
KEYSCANW:
	OR	(HL)		; SKIP OVER REST OF KEYWORD
	INC	HL
	JP	P,KEYSCANW
	XOR	B
KEYSCANB:
	LD	B,(HL)		; GET CODE FOR KEYWORD
	INC	HL
	EX	DE,HL
	POP	HL		; RESTORE STARTING POSITION
	PUSH	HL
	LD	C,0
	JP	P,KEYSCANC
	LD	A,(HL)		; NO MATCH, GET CHARACTER
KEYSCANF:
	POP	DE		; RECOVER OUTPUT POINTER
	POP	DE
	POP	BC
	LD	B,':'		; CHECK SPECIAL PROCESSING
	CP	KEYELS
	JP	NZ,KEYSCAND
	EX	DE,HL
	LD	(HL),B		; INSERT COLON BEFORE ELSE
	EX	DE,HL
	INC	DE
	INC	C
KEYSCAND:
	CP	KEYDAT
	JP	Z,KEYSCANI
	LD	B,0
	CP	KEYREM
	JP	Z,KEYSCANI
	CP	KEYCLD		; Pass file name in load and save
	JP	Z,KEYSCANI
	CP	KEYCSV
KEYSCANI:
	CALL	Z,KEYSCANV
	OR	A
	JP	Z,KEYSCANX
KEYSCANP:
	LD	(DE),A		; INSERT SYMBOL IN MEMORY
	INC	DE
	INC	C
KEYSCANH:
	INC	HL
	JP	KEYSCANL

;
;  Page 33
;

KEYSCANX:
	POP	HL		; EXIT KEYWORD TRANSLATION
	LD	(DE),A		; END OF STATEMENT
	INC	DE
	LD	(DE),A		; END OF 'PROGRAM'
	INC	DE
	LD	(DE),A
	LD	B,A		; LENGTHIN BC
	RET

;
;  COPY BUFFER TEXT WITHOUT PROCESSING
;
KEYSCANV:
	LD	(DE),A		; COPY TEXT VERBATIM TO STOPPER
	INC	C
	INC	DE
	INC	HL
	LD	A,(HL)
	OR	A
	RET	Z
	CP	B
	RET	Z
	CP	'"'		; STRING WITHIN TEXT?
	JP	NZ,KEYSCANV
	PUSH	BC
	LD	B,A
	CALL	KEYSCANV
	POP	AF
	LD	B,A
	LD	A,(HL)
	OR	A		; STRING TERMINATE ON END OF LINE?
	RET	Z
	JP	KEYSCANV

;
;  Page 34
;

;
;  LINE INPUT ROUTINE
;
INPTLNBS:
	DEC	HL		; DELETE A CHARACTER FROM INPUT
	DEC	B
	JP	Z,INPTLNRD
	CALL	PRNTCHRI	; Print (val)
	DEFB	'\'
	INC	C		; Char count
	JP	INPTLINL
INPTLNRD:
	LD	HL,MSGSTARS	; BREAK ENTERED
	CALL	PRNTMSG		; TELL HIM WE GOT IT
	DEC	B		; BREAK AT BEGINNING MEANS BREAK
	JP	Z,INPTEXIT

INPTCRLF:
	CALL	PRNTCRLF	; ON THE NEXT LINE
INPTRQST:
	LD	H,D
	LD	L,E		; PRINT USER'S PROMPT MESSAGE
	CALL	PRNTMSG
	LD	HL,(INPTBUFR)	; INPUT A LINE FROM RECEIVER
	LD	BC,1*256
	CALL	PRNTCHRI	; Print (val)
	DEFB	' '		; OK, WE'RE READY FOR INPUT
INPTLINL:
	LD	(HL),0		; MAINTAIN ENDING ZERO
	CALL	INPTCHAR
INPTLINC:
	CP	BEL
	JP	Z,INPTLNST	; BELL'S OK
	CP	CR
	JP	Z,INPTCRTN	; CARRIAGE RTN IS END OF LINE
	CP	BS
	JP	Z,INPTLNBS	; BACKSPACE IS DELETE
	CP	ETX		; CONTROL C IS ABORT
	JP	Z,INPTLNRD	; FORGET THIS LINE, START OVER
	CP	FF		; FORM FEEDS ARE ECHOED
	JP	Z,INPTLNEC
	CP	' '
	JP	C,INPTLINL	; IGNORE OTHER CONTROL CHARS

;
;  Page 35
;

INPTLNST:
	LD	(HL),A		; STORE THE CHARACTER
	LD	A,B
	CP	LINESYZE
	LD	A,BEL
	JP	NC,INPTLNEC
	INC	B
	OR	C
	LD	C,(HL)
	INC	HL
	LD	A,LF
	CALL	M,PRNTCHRA
	LD	A,C
INPTLNEC:
	CALL	PRNTCHRA	; Ac -> screen  ;ECHO CHARACTER
	JP	INPTLINL
INPTCRTN:
	DEC	B		; CARRIAGE RETURN AT BEGINNING
	JP	Z,INPTCRLF	; GETS ANOTHER TURN
INPTEXIT:
	LD	HL,(INPTBUFR)
	DEC	HL
	CALL	PRNTCRLF
	SUB	B		; SET CONDITION CODES
	CCF
	SBC	A,A		; NS=NC=Z = NON-EMPTY LINE
	RET

MSGSTARS:
	DEFB	'***',0

;
;  Page 36
;

;
;  SET OPTIONS COMMAND
;
SETSTM:
	JP	Z,ERRASN	; TURN OPTION ON OR OFF
	CP	KEYLIS
	JP	Z,SETSTMLS
	PUSH	AF		; SAVE OPTION
	CALL	SCANNXT		; Bscan ,
	JP	Z,ERRASN
	SUB	KEYON
	LD	B,A		; SAVE FLAG
	CALL	SCANNXT		; Bscan +
	POP	AF		; WHICH OPTION
	CP	KEYGTO
	JP	Z,SETSTMGT	; GOTO
	CP	KEYPRT
	JP	NZ,ERRASN
SETSTMPR:
	LD	A,B
	LD	(P3010),A	; Used to be printflg **
	RET
SETSTMGT:
	LD	A,B
	LD	(TRACEFLG),A
	RET
SETSTMLS:
	INC	HL
	CALL	VALBYTE
	CPL			; FIND NEGATIVE OF BYTE
	INC	A
	LD	(CURSLIM),A
	RET

;
;  DELETE COMMAND PROCESSOR
;
DELSTM:
	LD	DE,0FFFFH	; DELETE COMMAND
	CALL	SCANLPRZ
	EX	(SP),HL		; SAVE SCAN POINTER
	EX	DE,HL
	CALL	CMHLLTDE	; VERITY  FIRST<=LAST
	JP	C,ERRASN
	PUSH	HL
	CALL	LINESRCH	; LOOK FOR FIRST LINE
	POP	DE
	PUSH	BC
	CALL	LINESRCH	; LOOK FOR LAST LINE
	POP	BC
	CALL	LINEDEL
	POP	HL
	RET

;
; Page 37
;

;
;  LIST COMMAND PROCESSOR
;
LISSTM:
	LD	DE,0		; LIST COMMAND
	LD	BC,0FFFFH	; TOTAL DEFAULT IS ENTIRE FILE
	JP	Z,LISSTMSC
	LD	BC,0		; ELSE DEFAULT IS ONLY ONE LINE
LISSTMSC:
	CALL	SCANLPRM	; SCAN LINE PARAMETERS
	JP	NZ,ERRASN
	EX	(SP),HL
	EX	DE,HL
	PUSH	HL
	CALL	LINESRCH
	PUSH	BC
LISSTMLP:
	POP	BC		; MOVE ON TO NEXT LINE
	POP	DE
	POP	HL
	CALL	SYSBREAK	; ALLOW BREAK
	JP	Z,EXECUTEB
	PUSH	BC
	EX	(SP),HL
	CALL	LINELINK
	JP	Z,POPHLRET	; END OF PROGRAM, QUIT
	PUSH	DE
	PUSH	BC
	PUSH	HL		; SAVE TEXT FOR LATER
	LD	C,(HL)		; FETCH LINE NUMBER
	INC	HL
	LD	B,(HL)
	LD	H,B
	LD	L,C
	EX	DE,HL
	CALL	CMHLLTDE
	JP	C,LISSTMXT	; LAST LINE REACHED?
	CALL	PRNTCRLF	; LIST CURRENT LINE
	EX	DE,HL
	CALL	PRINTINT	; PRINT LINE NUMBER
	CALL	PRNTCHRI	; Print (val)
	DEFB	' '		; FOLLOWED BY BLANK
	POP	HL
	CALL	LISEDIXP	; EXPAND TEXT
	CALL	PRNTMSG		; AND PRINT IT
	LD	HL,0+LINESYZE+3
	ADD	HL,SP
	LD	SP,HL		; DEALLOCATE EXPANDED TEXT
	JP	LISSTMLP

;
;  Page 38
;
LISSTMXT:
	POP	HL
POPHL3RT:
	POP	HL
	POP	HL
POPHLRET:
	POP	HL
	RET


;
;  EXPAND KEYWORDS IN LINE / INVERSE OF KEYSCAN
;
LISEDIXP:
	LD	C,LINESYZE/2	; SPACE ENOUGH TO EXPAND LINE?
	CALL	SPACESTK
	EX	DE,HL		; SAVE POINTER TO LINE TO EXPAND
	POP	BC		; AND CALLER
	LD	HL,0-LINESYZE-3
	ADD	HL,SP
	LD	SP,HL		; CREATE TEXT BUFFER ON STACK
	PUSH	BC		; PUT BACK CALLER
	EX	DE,HL
	INC	HL
	INC	HL		; Plus 2
	PUSH	HL		; SAVE TEXT POINTER
	LD	HL,4		; CREATE POINTER TO EXPAND TEXT
	ADD	HL,SP
	EX	DE,HL
	LD	B,LINESYZE	; INITIALIZE LENGTH COUNTER
	JP	LISEDIKD
LISEDISC:
	CALL	LISEDIST	; STUFF ONE CHARACTER OF LINE
LISEDIKD:
	POP	HL		; DO REST OF LINE
	LD	A,(HL)
LISEDINC:
	INC	HL
	CP	':'
	JP	NZ,LISEDIKT
	LD	A,(HL)
	CP	KEYELS		; :ELSE BECOMES ELSE
	JP	Z,LISEDINC
	LD	A,':'
LISEDIKT:
	AND	A		; MOVE HIGH ORDER INTO S-FLAG
	JP	Z,LISEDIXT
	PUSH	HL
	JP	P,LISEDISC
	LD	C,A

;
;  Page 39
;

	LD	HL,KEYLSBH*256+KEYLSBL
	CALL	LISEDISB	; OPTIONAL BLANK BEFORE KEYWORD
	LD	HL,KEYWORDS	; SEARCH FOR KEYWORD
	JP	LISEDIKS
LISEDIKL:
	OR	(HL)
	INC	HL
	JP	P,LISEDIKL
LISEDIKS:
	LD	A,(HL)		; FETCH KEYWORD NUMBER
	OR	080H
	INC	HL
	XOR	C
	JP	NZ,LISEDIKL
LISEDIKY:
	LD	A,(HL)		; EXPAND KEYWORD
	RLCA
	AND	A		; HIGH-ORDER TO CARRY
	RRA
	CALL	LISEDIST	; STUFF THIS CHARACTER
	INC	HL
	JP	NC,LISEDIKY	; DO THEM ALL
	LD	A,C
	LD	HL,KEYLSAH*256+KEYLSAL
	CALL	LISEDISB	; OPTIONAL BLANK AFTER KEYWORD
	JP	LISEDIKD

LISEDISB:
	CP	L		; INSERT BLANK IN LINE IF
	RET	C		; L <= A < H
	CP	H
	RET	NC
	LD	A,' '		; GENERATE BLANK
LISEDIST:
	LD	(DE),A
	INC	DE
	DEC	B
	RET	NZ		; TRUNCATE TOO LONG A LINE
	INC	B
	DEC	HL
	RET

LISEDIXT:
	LD	(DE),A
	LD	A,LINESYZE+1	; COMPUTE LENGTH OF OUTPUT
	SUB	B
	LD	B,A
	LD	HL,2		; CREATE POINTER TO EXPAND TEXT
	ADD	HL,SP
	RET			; AND RETURN

;
;  Page 40
;

;
;  EDIT COMMAND PROCESSOR
;
EDISTM:
	LD	DE,0		; SCAN PARAMETERS
	CALL	SCANLPRZ
	EX	(SP),HL		; SAVE SCAN,
	LD	(SCANPTR1),HL	; AND OUTPUT LINE NUMBER
	CALL	LINESRCH	; LOOK UP LINE
	JP	NC,ERRAUS	; NOT FOUND...
	LD	H,B
	LD	L,C
	INC	HL
	INC	HL		; Plus 2
	CALL	LISEDIXP	; EXPAND LINE
	LD	HL,(SCANPTR1)	; RECOVER LINE NUMBER
	PUSH	HL
EDISTMLS:
	CALL	EDISTMCR	; GIVE HIM A LOOK AT IT
	CALL	PRNTMSG		; PRINT COPY OF TEXT
	CALL	EDISTMCR	; A NEW EDIT LINE
	LD	C,1		; POSITION COUNTER
EDISTMNX:
	CALL	EDISTMCH	; OK MASTER, TELL ME WHAT TO DO
	CP	' '		; MOVE ALONG
	JP	Z,EDISTMAD
	CALL	ALPHACHA	; CONVERT LOWER TO UPPER
	CP	'D'		; DELETE
	JP	Z,EDISTMDL
	CP	'I'		; INSERT
	JP	Z,EDISTMIN
	CP	'R'		; REPLACE
	JP	Z,EDISTMRP
EDISTMER:
	LD	A,BEL		; SQUAWK ABOUT ERROR
EDISTMEC:
	CALL	PRNTCHRA	; Ac -> screen
	JP	EDISTMNX

;  ADVANCE
;
EDISTMAD:
	LD	A,C
	CP	B		; CAN WE STILL ADVANCE?
	JP	NC,EDISTMER
	INC	C		; ADVANCE POSITION COUNTER
	LD	A,(HL)
	INC	HL		; PRINT CHARACTER PASSED OVER
	JP	EDISTMEC

;
;  Page 41
;

;  DELETE
;
EDISTMDL:
	LD	A,C
	CP	B		; ANYTHING TO DELETE?
	JP	NC,EDISTMER
	DEC	B		; DECREASE CHARACTER COUNT
	PUSH	HL		; SAVE CURRENT POSITION
	LD	A,(HL)
	CALL	PRNTCHRA	; LIST CHARACTER DELETED
	LD	D,H
	LD	E,L
EDISTMDM:
	INC	HL
	LD	A,(HL)		; MOVE THIS CHARACTER DOWNWARD
	LD	(DE),A
	INC	DE
	OR	A
	JP	NZ,EDISTMDM
	POP	HL
	JP	EDISTMNX

;  INSERT
;
EDISTMIN:
	CALL	EDISTMCH	; GET SOMETHING TO PUT IN
	LD	D,A		; SAVE COPY OF CHARACTER
EDISTMRI:
	LD	A,B
	CP	LINESYZE	; ROOM AT THE INNPUT BUFFER?
	JP	NC,EDISTMER
	INC	B		; COUNT NEWCOMER
	INC	C		; NEXT ONE GOES AFTER HIM
	LD	A,D
	CALL	PRNTCHRA	; Ac -> screen  ;PRINT NEWCOMER
	PUSH	HL		; SAVE CURRENT POSITION
EDISTMIM:
	LD	E,(HL)
	LD	(HL),A		; MOVE CHARACTERS UP ONE BYTE
	OR	A
	LD	A,E
	INC	HL
	JP	NZ,EDISTMIM
	POP	HL
	INC	HL
	JP	EDISTMIN

;
;  Page 42
;

;  REPLACE
;
EDISTMRP:
	CALL	EDISTMCH	; GET UPDATE CHARACTER
	LD	D,A
	LD	A,C
	CP	B		; REPLACING END OF LINE?
	JP	NC,EDISTMRI	; IF SO, GO TO INSERT
	LD	(HL),D		; UPDATE THE CHARACTER
	INC	C
	INC	HL
	LD	A,D
	CALL	PRNTCHRA	; Ac -> screen  ;PRINT NEWCOMER
	JP	EDISTMRP

;  SEARCH
;
EDISTMSR:
	CALL	EDISTMCH	; FIND CHARACTER TO SEARCH FOR
	CALL	ALPHACHA	; CONVERT TO STANDARD CASE
	LD	D,A
	LD	E,0
EDISTMSL:
	LD	A,C
	CP	B
	JP	NC,EDISTMER	; NO MORE, TERMINATE SEARCH
	CALL	ALPHACHK	; FETCH CHARACTER IN STANDARD CASE
	CP	E
	JP	Z,EDISTMNX	; GOTTA MATCH?
	CALL	PRNTCHRA	; Ac -> screen  ;LIST FAILURES
	INC	C
	INC	HL
	LD	E,D
	JP	EDISTMSL	; AND KEEP LOOKING

;
; Page 43
;

EDISTMXT:
	DEC	C		; BEGINNING CR MEANS DONE, UPDATE
	JP	NZ,EDISTMLS	; OTHERWISE, LIST, MORE EDITS
	POP	DE		; RETRIEVE LINE NUMBER
	LD	HL,0
	ADD	HL,SP		; POINT TO TEXT
	CALL	LINEINS		; AND REINSERT
EDISTMQT:
	LD	HL,0+LINESYZE+3
	ADD	HL,SP
	LD	SP,HL		; DEALLOCATE TEXT BUFFER
	POP	HL		; RECOVER SCAN POINTER
	RET			; AND RETURN

;  LIST LINE, PREPARE FOR UPDATES
;
EDISTMCR:
	POP	DE
	POP	HL		; RETRIEVE COPY OF LINE NUMBER
	PUSH	HL		; SAVE IT,
	PUSH	DE
	PUSH	BC		; AND LINE LENGTH
	CALL	PRNTCRLF
	CALL	PRINTINT	; PRINT LINE NUMBER
	CALL	PRNTCHRI	; Print (val)
	DEFB	' '
	LD	HL,6
	ADD	HL,SP		; CREATE POINTER TO TEXT BUFFER
	POP	BC
	RET

;  GET OPTION CHARACTER
;
EDISTMCH:
	CALL	INPTCHAR	; GET CHARACTER ROUTINE
	CP	' '
	RET	NC		; NOT CONTROL, RETURN
	CP	BEL
	RET	Z
	POP	DE		; REMOVE CALLER
	CP	HT		; SEARCH (TAB)
	JP	Z,EDISTMSR
	CP	CR		; LIST, OR UPDATE
	JP	Z,EDISTMXT
	CP	ESC		; TERMINATE OPTION
	JP	Z,EDISTMNX
	CP	ETX		; ABORT, NO UPDATE
	JP	NZ,EDISTMER
	LD	HL,MSGSTARS	; TYPE BREAK MESSAGE
	CALL	PRNTMSG
	POP	DE
	JP	EDISTMQT

;
;  Page 44
;

;
;  SCAN STACK FOR 'FOR' LOOP
;
FORBLCK EQU	16		; SIZE OF 'FOR' STACK ENTRY

FORCHK:
	LD	HL,4		; LOOK FOR MARK ON STACK
	ADD	HL,SP
FORCHKL:
	LD	A,(HL)
	INC	HL
	CP	KEYFOR
	RET	NZ
	LD	A,TYPESING
	LD	(TYPEFLG),A	; SET CORRECT TYPE FLAG
	LD	C,(HL)		; MARK IS PRESENT
	INC	HL
	LD	B,(HL)
	INC	HL
	PUSH	HL
	LD	H,B
	LD	L,C
	LD	A,D		; LOOKING FOR PARTICULAR VARIABLE?
	OR	E
	EX	DE,HL
	JP	Z,FORCHKXT
	EX	DE,HL		; IS THIS IT?
	CALL	CMHLLTDE
FORCHKXT:
	LD	BC,FORBLCK-3
	POP	HL
	RET	Z
	ADD	HL,BC
	JP	FORCHKL

;
;  FOR STATEMENT PROCESSOR
;
FORSTM:
	LD	A,SCANPFLD	; FOR STATEMENT
	LD	(SCANPFLG),A
	CALL	LETSTM
	CALL	TYPECHK
	JP	PE,ERRATM	; MUST BE SINGLE INDEX
	EX	(SP),HL		; SAVE SCANPTR, REMOVE CALLER
	EX	DE,HL
	LD	(VARINDEX),HL
	EX	DE,HL
	CALL	FORCHK
	POP	DE
	JP	NZ,FORSTMNF
	ADD	HL,BC
	LD	SP,HL
FORSTMNF:
	EX	DE,HL
	LD	C,(FORBLCK+1)/2

;
;  Page 45
;

	CALL	SPACESTK

	PUSH	HL
	CALL	DATSTM		; FIND FIRST STATEMENT IN FOR LOOP
	EX	(SP),HL		; AND SAVE
	PUSH	HL
	LD	HL,(CURLINE)	; SAVE CURRENT LINE NUMBER
	EX	(SP),HL
	CALL	SCANNXTV	; Bscan (val)
	DEFB	KEYTO		; SCAN LIMIT VALUE,
	CALL	VALNUMBR	; Bscan numbr
	PUSH	HL
	CALL	LDRGAC
	POP	HL
	PUSH	BC		; SAVE ON STACK
	PUSH	DE
	LD	BC,08100H	; LOAD DEFAULT STEP=1.0
	LD	D,C
	LD	E,D
	LD	A,(HL)
	CP	KEYSTEP		; CHECK FOR EXPLICIT STEP SIZE
	LD	A,001H
	JP	NZ,FORSTMST
	CALL	SCANNXT		; Bscan +
	CALL	VALNUMBR	; Bscan numbr
	PUSH	HL
	CALL	LDRGAC
	POP	HL
	CALL	SIGNACC
FORSTMST:
	PUSH	BC		; SAVE STEP SIZE ON STACK
	PUSH	DE
	PUSH	AF		; SAVE DIRECTION
	INC	SP
	PUSH	HL
	LD	HL,(VARINDEX)	; SAVE INDEX VARIABLE
	EX	(SP),HL
FORMARK:
	LD	B,KEYFOR	; MARK STACK WITH 'FOR'
	PUSH	BC
	INC	SP

;
;  Page 46
;

;
;  INTERPRETER EXECUTIVE
;
EXECUTEL:
	CALL	BREAKCHK	; USER HAVE ANY COMMENTS?
	LD	(PROGCNTR),HL
	LD	A,(HL)
	CP	':'
	JP	Z,EXECUTE	; MUTIPLE STATEMENTS ON LINE?
	OR	A
	JP	NZ,ERRASN
	INC	HL		; END OF LINE,
	LD	A,(HL)
	INC	HL
	OR	(HL)
	INC	HL
	JP	Z,ENDPROGM	; END OF PROGRAM?
	LD	E,(HL)
	INC	HL
	LD	D,(HL)
	EX	DE,HL
	LD	(CURLINE),HL	; MOVE TO NEXT LINE
	EX	DE,HL
EXECUTE:
	CALL	SCANNXT		; Bscan ,  ;EXECUTE STATEMENT
	LD	DE,EXECUTEL
	PUSH	DE
EXECUTEC:
	RET	Z
EXECUTES:
	CP	KEYSTM		; WHAT KIND OF STATEMENT?
	JP	C,LETSTM
	CP	KEYSUGR
	JP	NC,EXECUTE2
	ADD	A,A
	LD	C,A
	LD	B,000H
	EX	DE,HL
	LD	HL,STMTABL
	ADD	HL,BC
	LD	C,(HL)
	INC	HL
	LD	B,(HL)
	PUSH	BC
	EX	DE,HL
	JP	SCANNXT

;
;  Page 47
;

BREAKCHK:
	CALL	SYSBREAK	; TIME TO TAKE A BREAK?
STPSTM:
	RET	NZ		; STOP STATEMENT
	INC	A
EXECUTEB:
	LD	(PROGCNTR),HL
INPSTMBR:
	POP	BC		; THROW AWAY CALLER
ENDPROGM:
	PUSH	AF
	LD	HL,(CURLINE)
	LD	A,L
	AND	H
	INC	A
	JP	Z,ENDSTMC
	LD	(CURLINES),HL	; SAVE INFORMATION FOR CONTINUE
	LD	HL,(PROGCNTR)
	LD	(PROGCNTS),HL
ENDSTMC:
	XOR	A
	LD	(PRINTFLG),A
	POP	AF
	LD	HL,MSGBREAK
	JP	NZ,ERRMSGPR
	JP	CMNDSTRT

CONSTM:
	RET	NZ		; CONT COMMAND
	LD	E,ERRNCN-ERRN
	LD	HL,(PROGCNTS)
	LD	A,H
	OR	L
	JP	Z,ERRMSG
	EX	DE,HL
	LD	HL,(CURLINES)
	LD	(CURLINE),HL
	EX	DE,HL
	RET

RUNSTM:
	JP	Z,CLEARSET	; RUN COMMAND
	CALL	CLEARVST
	LD	BC,EXECUTEL
	JP	RUNSTMC

ENDSTM:
	JP	Z,EXECUTEB	; END STATEMENT
	CALL	SCANNXTV	; Bscan (val)
	DEFB	KEYRUN
	JP	SYSQUIT

;
;  Page 48
;

;
;  GOSUB/GOTO STATEMENTS
;
GSBSTM:
	LD	C,3		; GOSUB STATEMENT
	CALL	SPACESTK
	POP	BC
	PUSH	HL
	PUSH	HL
	LD	HL,(CURLINE)
	EX	(SP),HL
	LD	D,KEYGSB	; MARK STACK WITH GOSUB
	PUSH	DE
	INC	SP
RUNSTMC:
	PUSH	BC
GTOSTM:
	CALL	SCANLINN	; GOTO STATEMENT
	PUSH	DE
	CALL	REMSTM
	POP	DE
	PUSH	HL
	CALL	TRACE
	LD	HL,(CURLINE)
	CALL	CMHLLTDE
	POP	HL
	INC	HL
	CALL	C,LINESRCL
	CALL	NC,LINESRCH
	LD	H,B
	LD	L,C
	DEC	HL
	RET	C
ERRAUS:
	LD	E,ERRNUS-ERRN
	JP	ERRMSG

;
;  RETURN STATEMENT
;
RETSTM:
	RET	NZ		; RETURN STATEMENT
	LD	D,0FFH
	CALL	FORCHK		; KILL ACTIVE FOR LOOPS
	LD	SP,HL		; INSIDE SUBROUTINE
	CP	KEYGSB
	LD	E,ERRNRG-ERRN
	JP	NZ,ERRMSG
	POP	DE
	CALL	TRACE
	EX	DE,HL
	LD	(CURLINE),HL
	LD	HL,EXECUTEL
	EX	(SP),HL
;	JMP	DATSTM

;
;  Page 49
;

;
;  DATA/ELSE/REM STATEMENTS
;
DATSTM:
	LD	C,':'		; DATA STATEMENT
	JP	SCAN2KEY
ELSSTM:

REMSTM:
	LD	C,000H		; REM STATEMENT
SCAN2KEY:
	LD	B,000H		; SKIP TO KEYWORD IN C
DATRSKST:
	LD	A,C		; SET UP TERMINATING BYTE
	LD	C,B
	LD	B,A
DATRSKIP:
	LD	A,(HL)		; SKIP TO TERMINATING BYTE
	OR	A
	RET	Z
	CP	B
	RET	Z
	INC	HL
	CP	'"'		; STRING TO SKIP?
	JP	Z,DATRSKST
	CP	KEYIF
	JP	NZ,DATRSKIP
	INC	D		; COUNT NUMBER OF IFS WE SKIP
	JP	DATRSKIP

;
;  PROGRAM BRANCH TRACING
;
TRACE:
	LD	A,(TRACEFLG)	; TRACING?
	OR	A
	RET	NZ
	PUSH	BC
	PUSH	DE		; SAVE DESTINATION LINE NUMBER
	CALL	PRNTCHRI	; Print (val)
	DEFB	'['		; LEFT BRACKET
	LD	HL,(CURLINE)
	CALL	PRINTINT	; PRINT CURRENT LINE NUMBER
	CALL	PRNTCHRI	; Print (val)
	DEFB	','
	POP	HL
	PUSH	HL
	CALL	PRINTINT	; PRINT DESTINATION LINE NUMBER
	CALL	PRNTCHRI	; Print (val)
	DEFB	']'		; RIGHT BRACKET
POPDEBCR:
	POP	DE
	POP	BC
	RET

;
;  Page 50
;

;
;  ASSIGNMENT STATEMENT PROCESSOR
;
LETSTM:
	CALL	VARSCAN		; LET STATEMENT
	CALL	SCANNXTV	; Bscan (val)
	DEFB	KEYEQ
ASSIGNVL:
	LD	A,(TYPEFLG)
	PUSH	AF
	PUSH	DE
	CALL	VALEXPR		; Bscan expr
	POP	DE
	POP	AF
ASSIGN:
	EX	DE,HL		; MAKE THE ASSIGMENT
	PUSH	DE		; SAVE SCAN
	PUSH	HL		; SAVE VARIABLE
	CALL	COERCE
	JP	NZ,LETSTMNM
	CALL	STRGUNIQ	; REMOVE CONFLICT PROBLEMS
	CALL	STRGRELT	; RELEASE STRING TEMPORARY
	POP	HL		; COPY DESCRIPTOR TO DESTINATION
	CALL	COPYVAL
	POP	HL
	RET

LETSTMNM:
	CALL	LDMMAC		; MAKE NUMERIC ASSIGNMENT
	POP	DE
	POP	HL
	RET

STRGUNIQ:
	LD	HL,(ACCUMLTR)	; GET STRING DESCRIPTOR
	EX	DE,HL		; IS STRING IN STRING SPACE?
	CALL	STRGTEST
	RET	NC
	CALL	CMHLLTDE	; VARIABLE REFERENCE?
	CALL	NC,STRGSTOR	; IF SO, MAKE NEW COPY
	RET

;
;  Page 51
;

;
;  COERCE ACCUMULATOR TO TYPE IN A
;
COERCE:
	CALL	TYPECHKA
COERCEF:
	JP	PO,CSINGLE
	JP	Z,CSTRING
	JP	ERRATM

VALNUMBR:
	CALL	VALEXPR		; Bscan expr
CSINGLE:
	CALL	TYPECHK
	RET	PO
	JP	ERRATM

CSTRING:
	CALL	TYPECHK
	RET	Z
	JP	ERRATM

ERRATM:
	LD	E,ERRNTM-ERRN
	JP	ERRMSG

VALINTDE:
	CALL	VALNUMBR	; Bscan numbr EVAL POSITIVE INTEGER EXPR
CINTPOS:
	CALL	SIGNACC		; CONVERT TO INTEGER
	JP	M,ERRAFC
CINTEGER:
	LD	A,(FLACCEXP)
	CP	090H
	JP	C,FIXAC
	LD	BC,09080H
	LD	DE,00000H
	CALL	FLCMP
	LD	D,C
	RET	Z

ERRAFC:
	LD	E,ERRNFC-ERRN
	JP	ERRMSG

VALBYTE2:
	CALL	SCANNXTV	; Bscan (val)
	DEFB	','		; EVAL LATER BYTE ARGUMENTS
VALBYTE:
	CALL	VALNUMBR	; Bscan numbr EVAL BYTE EXPRESSION
CBYTE:
	CALL	CINTPOS		; CONVERT ACC TO BYTE
	LD	A,D
	OR	A
	JP	NZ,ERRAFC

;
;  Page 52
;

	DEC	HL
	CALL	SCANNXT		; Bscan ,
	LD	A,E
	RET

EXECUTE2:
	CP	KEYPORT		; PORT OUTPUT?
	JP	Z,PORSTM
	CP	KEYMEM		; MEMORY ALTERATION?
	JP	Z,MEMSTM

;
;  MID-STRING ASSIGNMENT STATEMENT
;
MIDSTM:
	CALL	SCANNXTV	; Bscan (val)
	DEFB	KEYMID		; ENTER POINTING TO 'MID$'
	CALL	SCANNXTV	; Bscan (val)
	DEFB	'('
	CALL	VARSCAN		; SCAN VARIABLE TO UPDATE
	CALL	CSTRING		; MAKE SURE IT'S A STRING
	PUSH	DE		; SAVE REFERENCE
	PUSH	HL
	CALL	STRGTEST	; WHERE IS STRING NOW?
	PUSH	DE		; SHOULDN'T BE IN PROGRAM
	CALL	NC,STRGSTOR	; OR ELSE WE MODIFY OURSELF
	POP	HL
	CALL	COPYVAL
	POP	HL		; CONTINUE SCAN
	CALL	VALBYTE2	; SCAN STARTING POSITION
	OR	A
	JP	Z,ERRAFC	; MUST BE NON-ZERO
	PUSH	DE
	LD	E,0FFH
	LD	A,(HL)
	CP	')'		; DEFAULT LENGTH?
	CALL	NZ,VALBYTE2	; SCAN LENGTH, IF GIVEN
	CALL	SCANNXTV	; Bscan (val)
	DEFB	')'
	POP	BC		; CONDENSE STACK
	LD	D,C
	PUSH	DE
	CALL	SCANNXTV	; Bscan (val)
	DEFB	KEYEQ
	CALL	VALEXPR		; Bscan expr  ;EVALUATE RIGHT HAND SIDE
	LD	(SCANPTR1),HL
	CALL	LENFCTC		; RELEASE STRING RESOURCE
	LD	C,(HL)		; AND LOAD DESCRIPTOR
	INC	HL
	LD	B,(HL)
	POP	DE		; GET BACK LENGTH, START
	CP	E
	JP	NC,MIDSTMLN	; LENMOV = MIN(LENI, LENS)
	LD	E,A
MIDSTMLN:
	POP	HL		; RECOVER DESTINATION DESCRIPTOR

;
;  Page 53
;

	LD	A,(HL)		; GET ITS LENGTH
	DEC	D
	SUB	D		; SUBTRACT STARTING POSITION
	JP	C,MIDSTMXT	; NOTHING TO DO IF BEYOND

;
;  Page 54
;

	CP	E
	JP	NC,MIDSTMLM
	LD	E,A
MIDSTMLM:
	PUSH	BC		; SAVE SOURCE ADDRESS
	CALL	LDICBMM		; COMPUTE DESTINATION ADDRESS
	LD	L,D
	LD	H,0
	ADD	HL,BC
	EX	DE,HL
	POP	BC
	CALL	COPYSTRG	; COPY STRING
MIDSTMXT:
	LD	HL,(SCANPTR1)
	RET

;
;  LOCATE STRING REFERENCE BY DE
;
STRGTEST:
	PUSH	DE		; DE=STRING REFERENCE
	EX	DE,HL
	INC	HL		; GET ADDRESS OF STRING
	LD	E,(HL)
	INC	HL
	LD	D,(HL)
	LD	HL,(FREELIMT)	; BOUNDARY
	CALL	CMHLLTDE	; NC = STRING IN PROGRAM
	POP	DE		; C = STRIN IN BUFFER
	RET			; OR STRING SPACE

;
;  Page 55
;

;
;  CASE/CONDITINAL STATEMENT PROCESSORS
;
ONSTM:
	CALL	VALBYTE		; ON STATEMENT
	LD	A,(HL)
	LD	B,A
	CP	KEYGSB		; GOSUB RATHER THAN GOTO?
	JP	Z,ONNSTMC
	CALL	SCANNXTV	; Bscan (val)
	DEFB	KEYGTO		; MUST BE GOTO...
	DEC	HL
ONNSTMC:
	LD	C,E
ONNSTMSL:
	DEC	C		; LOOK FOR RIGHT LINE NUMBER
	LD	A,B
	JP	Z,EXECUTES	; THEN EXECUTE STATEMENT
	CALL	SCANLINR
	CP	','
	RET	NZ
	JP	ONNSTMSL



IFSTM:
	CALL	VALNUMBR	; Bscan numbr  ;IF STATEMENT
	LD	A,(HL)
	CP	KEYGTO
	JP	Z,IFNSTMC
	CALL	SCANNXTV	; Bscan (val)
	DEFB	KEYTHEN
IFNSTMC:
	CALL	SIGNACC		; TEST CONDITION
	JP	NZ,IFNSTMCH
	LD	D,1
IFNSTMSK:
	LD	C,KEYELS
	CALL	SCAN2KEY	; SKIP TO CORRESPONDING ELSE
	OR	A
	RET	Z		; OR END OF LINE
	CALL	SCANNXT		; Bscan +
	DEC	D
	JP	NZ,IFNSTMSK
IFNSTMCH:
	DEC	HL		; Bscan -
	CALL	SCANNXT		; Bscan ,  ;CHOICE MADE
	JP	C,GTOSTM	; GOTO A LABEL,
	JP	EXECUTEC	; OR EXECUTE A STATEMENT

;
; Page 56
;

;
;  PRINT STATEMENT PROCESSOR
;
PRTSTMN:
	CP	KEYTAB		; TAB OPTION?
	JP	Z,PRNTOPTN
	CP	KEYSPC		; SPACE OPTION
	JP	Z,PRNTOPTN
	PUSH	HL
	CP	','
	JP	Z,PRNTCOMA
	CP	';'
	JP	Z,PRNTSEMI
	POP	BC
	CALL	VALEXPR		; Bscan expr
	DEC	HL		; Bscan -
	PUSH	HL
	CALL	TYPECHK
	JP	Z,PRTSTRNG
	CALL	VALSTRGN	; CREATE STRING FROM NUMBER
	LD	HL,(ACCUMLTR)	; VERIFY ROOM ENOUGH ON LINE
	LD	A,(HL)
	LD	HL,CURSPOS
	ADD	A,(HL)
	INC	HL
	ADD	A,(HL)
	CALL	C,PRNTCRLF	; NO ROOM, FIND ANOTHER LINE
	CALL	PRNTSTRT
	CALL	PRNTCHRI	; Print (val)
	DEFB	' '
	INC	A
PRTSTRNG:
	CALL	Z,PRNTSTRT	; SEND OUTPUT STRING
	POP	HL
	CALL	SCANNXT		; Bscan ,
PRTSTM:
	JP	NZ,PRTSTMN	; PRINT STATEMENT
PRNTCRLF:
	CALL	PRNTCHRI	; Print (val)
	DEFB	CR		; PRINT A CR, LF
	CALL	PRNTCHRI	; Print (val)
	DEFB	LF
PRNTNULS:
	LD	A,(NULLCNT)	; PRINT NULLS AFTER CR
PRNTNULL:
	DEC	A
	LD	(CURSPOS),A
	RET	Z
	PUSH	AF
	XOR	A
	CALL	PRNTCHRA	; Ac -> screen
	POP	AF
	JP	PRNTNULL

;
;  Page 57
;

PRNTCOMA:
	LD	A,(CURSPOS)	; COMMA SEPARATOR
	CP	((LINESYZE/ITEMSIZE)-1)*ITEMSIZE
	CALL	NC,PRNTCRLF
	JP	NC,PRNTSEMI
PRNTCOML:
	SUB	ITEMSIZE
	JP	NC,PRNTCOML
	CPL
	JP	PRNTCOMC

PRNTOPTN:
	PUSH	AF
	CALL	SCANNXT		; Bscan +
	CALL	VALPARNS	; GET OPTION PARAMETER
	CALL	CSINGLE
	CALL	CBYTE
	DEC	HL
	POP	AF
	CP	KEYSPC
	PUSH	HL
	LD	A,E
	JP	Z,PRNTBLNK
	LD	A,(CURSPOS)
	CPL
	ADD	A,E
	JP	NC,PRNTSEMI
PRNTCOMC:
	INC	A
PRNTBLNK:
	LD	B,A		; PAD OUTPUT WITH A BLANKS
	OR	A
	JP	Z,PRNTSEMI
	LD	A,' '
PRNTBLNL:
	CALL	PRNTCHRA	; Ac -> screen
	DEC	B
	JP	NZ,PRNTBLNL
PRNTSEMI:
	POP	HL
	CALL	SCANNXT		; Bscan ,
	RET	Z
	JP	PRTSTMN

;
;  Page 58
;

PRNTNUMS:
	INC	HL		; SEND STRING TO TRANSMITTER
PRNTMSG:
	PUSH	BC
	PUSH	DE
	LD	BC,POPDEBCR
	PUSH	BC
	CALL	VALSTRGZ	; STRING ENDS ON ZERO
PRNTSTRT:
	CALL	STRGRELA
	CALL	LDDCBMM
	INC	D
PRNTSTRL:
	DEC	D
	RET	Z
	LD	A,(BC)
	CALL	PRNTCHRA	; Ac -> screen
	CP	CR
	CALL	Z,PRNTNULS
	INC	BC
	JP	PRNTSTRL

;
;  RETURN CURRENT POTITION ON OUTPUT LINE
;
POSFCT:
	LD	A,(CURSPOS)	; POS FUNCTION
FLOATA:
	LD	B,A		; RETURN BYTE ANSWER
	XOR	A
	JP	FLOATAB

;
;  PLOT STATEMENT
;
PLTSTM:
	CALL	VALNUMBR	; Bscan numbr  ;GET X-COORDINATE
	CALL	CINTEGER
	PUSH	DE
	CALL	SCANNXTV	; Bscan (val)
	DEFB	','
	CALL	VALNUMBR	; Bscan numbr  ;GET Y-COORDINATE
	CALL	CINTEGER
	PUSH	DE
	CALL	SCANNXTV	; Bscan (val)
	DEFB	','
	CALL	VALNUMBR	; Bscan numbr  ;GET OPERATION
	CALL	CINTEGER
	LD	A,E
	POP	DE
	POP	BC
	PUSH	HL
;	CALL	SYSPLOT
	POP	HL
	RET

;
;  Page 59
;

;
;  INPUT/READ STATEMENT PROCESSORS
;
MSGQUES:
	DEFB	'??',0
MSGREDO:
	DEFB	'?REDO FROM START',CR,LF,0
MSGEXTRA:
	DEFB	'?EXTRA IGNORED',CR,LF,0

;  INPUT
;
INPSTM:
	XOR	A		; INPUT STATEMENT
	LD	(PRINTFLG),A	; TURN ON PRINTING
INPSTMRD:
	PUSH	HL		; SAVE SCAN IN CASE OF ERROR
	LD	C,LINESYZE/2
	CALL	SPACESTK
	EX	DE,HL
	LD	HL,(INPTBUFR)	; SAVE ADDRESS OF CURRENT BUFFER
	PUSH	HL
	LD	HL,0-LINESYZE-3
	ADD	HL,SP
	LD	SP,HL		; AND CREATE A NEW BUFFER
	LD	(INPTBUFR),HL
	EX	DE,HL
	LD	A,(HL)
	CP	'"'
	JP	Z,INPSTMPR
	CP	KEYPRM
	LD	DE,MSGQUES+1
	JP	NZ,INPSTMIN
	CALL	SCANNXT		; Bscan +
INPSTMPR:
	CALL	VALEXPR		; Bscan expr  ;OPTIONAL PROMPT STRING
	CALL	CSTRING
	CALL	SCANNXTV	; Bscan (val)
	DEFB	';'
	PUSH	HL
	CALL	PRNTSTRT
	POP	HL
	LD	DE,MSGQUES+2
INPSTMIN:
	PUSH	HL
	CALL	DATAINPT

;
;  Page 60
;

	JP	REAINPFS

;  READ
;
REASTM:
	PUSH	HL		; READ STATEMENT
	LD	HL,(CURDATAP)
	LD	A,(HL)
	OR	A
	CALL	Z,DATASRCH	; GET DATA IF NECESSARY

REAINPFS:
	LD	(REAINPFL),A
	JP	REAINPLQ
REAINPLP:
	CALL	SCANNXTV	; Bscan (val)
	DEFB	','
	EX	(SP),HL
	LD	A,(HL)
	CP	','
	CALL	NZ,DATAGET
REAINPLQ:
	EX	(SP),HL
	LD	A,(HL)
	CP	KEYLINE		; LINE OPTION?
	JP	Z,INPSTMLN
	CALL	VARSCAN		; FIND NEXT VARIABLE TO BE INPUT
	EX	(SP),HL		; SAVE INPUT LIST POINTER
	PUSH	DE		; SAVE VARIABLE POINTER,
	LD	A,(TYPEFLG)	; AND TYPE
	PUSH	AF
	CALL	REAINPDC	; DECODE INPUT
REAINPLA:
	POP	AF		; ASSIGN VALUE
	POP	DE
	CALL	ASSIGN
	DEC	HL		; Bscan -
	CALL	SCANNXT		; Bscan ,
	JP	Z,REAINPCM
	CP	','		; DATA ITEMS SEPARTED BY COMMAS
	JP	NZ,REAINPER
REAINPCM:
	EX	(SP),HL
	DEC	HL		; Bscan -  ;MORE VARIABLES?
	CALL	SCANNXT		; Bscan ,
	JP	NZ,REAINPLP
	POP	DE		; END OF VARLIST
	LD	A,(REAINPFL)
	OR	A
	EX	DE,HL
	JP	NZ,RESDTPTR
	PUSH	DE
	PUSH	AF
	OR	(HL)
	LD	HL,MSGEXTRA
INPSTMER:

;
;  Page 61
;

	CALL	NZ,PRNTMSG
	POP	AF

;
;  Page 62
;

INPSTMXT:
	POP	DE		; RECOVER SCAN POINTER
	LD	HL,0+LINESYZE+3
	ADD	HL,SP
	LD	SP,HL		; DEALLOCATE BUFFER
	POP	HL
	LD	(INPTBUFR),HL	; AND RESTORE ADDRESS OF OLD
	EX	DE,HL
	POP	DE
	RET	Z
	JP	M,INPSTMBR	; BREAK TIME...
	EX	DE,HL
	JP	INPSTMRD	; OR REDO THE INPUT

REAINPER:
	LD	A,(REAINPFL)
	OR	A
	JP	NZ,ERRDATA
	LD	HL,MSGREDO
	INC	A
	PUSH	AF
	JP	INPSTMER

;
;  SEARCH FOR DATA STATEMENT
;
DATAGET:
	LD	A,(REAINPFL)
	OR	A		; READ OR INPUT?
	LD	DE,MSGQUES
	JP	Z,DATAINPT	; INPUT
DATASRCH:
	CALL	DATSTM		; LOOK FOR NEXT DATA STATEMENT
	OR	A
	JP	NZ,DATASRCK
	INC	HL
	LD	A,(HL)
	INC	HL
	OR	(HL)
	INC	HL
	LD	E,ERRNOD-ERRN
	JP	Z,ERRMSG
	LD	E,(HL)
	INC	HL
	LD	D,(HL)
	EX	DE,HL
	LD	(CURLDATA),HL
	EX	DE,HL
DATASRCK:
	CALL	SCANNXT		; Bscan ,
	CP	KEYDAT
	JP	NZ,DATASRCH
	RET

DATAINPT:

;
;  PAGE 63
;

	CALL	INPTRQST
	RET	Z		; INPUT OK, RETURN
	POP	BC		; BREAK ***
	JP	INPSTMXT

REAINPDC:
	CALL	SCANNXT		; Bscan ,
	CALL	TYPECHK
	LD	A,(HL)
	JP	NZ,DECODE	; READ/INPUT A NUMBER
	CP	'"'
	JP	Z,VALSTRGC
	LD	D,':'
	LD	B,','
	DEC	HL
	JP	VALSTRGS	; READ/INPUT A STRING

INPSTMLN:
	LD	A,(REAINPFL)	; LINE OPTION VALID ONLY
	OR	A		; FOR INPUT STATEMENT
	JP	NZ,ERRASN
	CALL	SCANNXT		; Bscan +
	CALL	VARSCAN
	EX	(SP),HL
	PUSH	DE
	LD	A,(TYPEFLG)
	PUSH	AF
	LD	B,0
	CALL	VALSTRGY	; SWALOW REST OF INPUT LINE
	JP	REAINPLA	; AND ASSIGN TO STRING VARIABLE

;
;  Page 64
;

;
;  NEXT STATEMENT PROCESSOR
;
NEXSTM:
	LD	DE,0		; NEXT STATEMENT
NEXSTML:
	CALL	NZ,VARSCAN
	LD	(PROGCNTR),HL
	CALL	FORCHK		; VERIFY WE'RE IN FOR LOOP
	JP	NZ,ERRANF
	LD	SP,HL		; BACK UP STACK
	PUSH	DE
	LD	A,(HL)		; RECOVER SIGN OF STEPSIZE
	INC	HL
	PUSH	AF
	PUSH	DE
	CALL	LDRGACMM	; RECOVER STEP SIZE
	EX	(SP),HL
	PUSH	HL
	CALL	FLADDM		; INCREMENT CONTROL VARIABLE
	POP	HL
	CALL	LDMMAC
	POP	HL
	CALL	LDRGMM
	PUSH	HL
	CALL	FLCMP
	POP	HL
	POP	BC
	SUB	B
	CALL	LDRGMM		; RECOER LINE NUMBR, PROGRAM CNTR
	JP	Z,NEXSTMC	; CHECK LIMIT
	CALL	TRACE
	EX	DE,HL
	LD	(CURLINE),HL
	LD	H,B
	LD	L,C
	JP	FORMARK

ERRANF:
	LD	E,ERRNNF-ERRN
	JP	ERRMSG

NEXSTMC:
	LD	SP,HL		; END OF LOOP...
	LD	HL,(PROGCNTR)
	LD	A,(HL)
	CP	','
	JP	NZ,EXECUTEL	; MORE INDICES?
	CALL	SCANNXT		; Bscan	,
	CALL	NEXSTML

;
;  Page 65
;

;
;  EVALUTATE AN EXPRESSION
;
VALEXPR:
	DEC	HL		; SCAN & EVALUATE AN EXPRESSION
	LD	D,0		; INITIAL PRECEDENCE=0
VALEXPRL:
	PUSH	DE
	LD	C,1
	CALL	SPACESTK
	CALL	VALPRMRY	; Bscan prmry
	LD	(SCANPTR2),HL
VALEXPRC:
	LD	HL,(SCANPTR2)
VALEXPRD:
	POP	BC		; PREVIOUS PRECEDENCE
	LD	A,B
	CP	PREDNUM
	CALL	NC,CSINGLE
	LD	A,(HL)
	LD	D,000H
VALEXPRR:
	SUB	KEYREL		; RELATION?
	JP	C,VALEXPRO
	CP	KEYFCT-KEYREL
	JP	NC,VALEXPRO
	CP	1		; YES
	RLA
	XOR	D		; CONVERT 0,1,2 TO 1,2,4
	CP	D
	LD	D,A
	JP	C,ERRASN
	LD	(SCANPTR1),HL
	CALL	SCANNXT		; Bscan ,
	JP	VALEXPRR

VALEXPRO:
	LD	A,D
	OR	A
	JP	NZ,VALREL
	LD	A,(HL)
	LD	(SCANPTR1),HL
	SUB	KEYOPR		; OPERATOR?
	RET	C
	CP	KEYREL-KEYOPR
	RET	NC
	LD	E,A		; YES
	CALL	TYPECHK		; STRING OPERANDS?
	OR	E		; AND CATENATION OPERATOR?
	LD	A,E
	JP	Z,VALCONCT	; YES
	ADD	A,E
	ADD	A,E
	LD	E,A
	LD	HL,OPRTABL

;
;  Page 66
;

	ADD	HL,DE
	LD	A,B
	LD	D,(HL)
	CP	D
	RET	NC
	INC	HL
	CALL	CSINGLE
VALEXPR2:
	PUSH	BC		; STACK OPERATION
	LD	BC,VALEXPRC	; EVALUATE SECOND OPERAND
	PUSH	BC
	LD	B,D
	LD	C,E
	CALL	PUSHAC
	LD	D,B
	LD	E,C
	LD	C,(HL)
	INC	HL
	LD	B,(HL)
	PUSH	BC
	LD	HL,(SCANPTR1)
	JP	VALEXPRL

;
;  EVALUATE A RELATION
;
VALREL:
	LD	HL,RELOPR	; SCAN & EVALUATE RELATION
	LD	A,(TYPEFLG)
	RLCA
	RLCA
	RLCA
	OR	D
	LD	E,A
	LD	D,PREDREL
	LD	A,B
	CP	D
	RET	NC
	JP	VALEXPR2

RELOPRXT:
	INC	A		; MATCH RESULF OF COMPARISON
	ADC	A,A		; -1,0,1 TO 1,2,4
	POP	BC		; VERSUS RELATION TO BE TESTED
	AND	B
	ADD	A,-1
	SBC	A,A
	JP	FLOATBYT

;
;  Page 67
;

RELOPR:
	DEFW	RELOPRC		; COMPUTE RELATION
RELOPRC:
	LD	A,C
	POP	BC
	POP	DE
	PUSH	AF
	RRCA
	RRCA
	RRCA
	AND	00FH
	CALL	COERCE
	LD	HL,RELOPRXT
	PUSH	HL
	JP	NZ,FLCMP	; NUMERIC COMPARISON?
	LD	A,TYPESING	; NO, STRING
	LD	(TYPEFLG),A
	PUSH	DE
	CALL	STRGRELA	; RELEASE TEMP OF SECOND OPERAND
	POP	DE
	LD	C,(HL)
	INC	HL
	PUSH	BC		; SAVE LENGTH
	LD	C,(HL)
	INC	HL
	LD	B,(HL)
	PUSH	BC		; AND ADDRESS
	CALL	STRGRELD	; RELEASE TEMP OF FIRST OPERAND
	CALL	LDDCBMM
	POP	HL
	EX	(SP),HL
	LD	E,L
	POP	HL
RELOPRSL:
	LD	A,E		; COMPARE CHARACTER BY CHARACTER
	OR	D
	RET	Z
	LD	A,E
	SUB	1
	RET	C
	XOR	A
	CP	D
	INC	A
	RET	NC
	DEC	D
	DEC	E
	LD	A,(BC)
	CP	(HL)
	INC	HL
	INC	BC
	JP	Z,RELOPRSL
	CCF
	JP	CMPXT

;
;  Page 68
;

;
;  EVALUATE A PRIMARY
;
VALPRMRY:
	LD	A,TYPESING	; SCAN & EVALUATE A PRIMARY
	LD	(TYPEFLG),A
	CALL	SCANNXT		; Bscan ,
	JP	C,DECODE	; NUMERIC CONSTANT?
	CALL	ALPHACHK
	JP	C,VALVAR	; VARIABLE?
	CP	KEYADD
	JP	Z,VALPRMRY
	CP	'.'
	JP	Z,DECODE
	CP	KEYSUB
	JP	Z,VALUMINS
	CP	'"'		; STRING CONSTANT?
	JP	Z,VALSTRGC
	CP	KEYNOT
	JP	Z,VALUNOT
	CP	KEYFN		; DEFINED FUNCTION?
	JP	Z,VALFCTD
	CP	KEYIF		; CONDITIONAL EXPRESSION?
	JP	Z,VALCOND
	SUB	KEYFCT		; INSTRISIC FUNCTION?
	JP	NC,VALFCTN
VALPARNS:
	CALL	SCANNXTV	; Bscan (val)
	DEFB	'('
VALPARN2:
	CALL	VALEXPR		; Bscan expr
	CALL	SCANNXTV	; Bscan (val)
	DEFB	')'
	RET

VALUMINS:
	LD	D,PREDUMIN	; EVALUATE UNARY MINUS
	CALL	VALEXPRL
	LD	HL,(SCANPTR2)
	PUSH	HL
	CALL	CMACCS
VALRETNM:
	CALL	CSINGLE
	POP	HL
	RET

;
;  Page 69
;

;
;  EVALUATE A VARIABLE
;
VALVAR:
	CALL	VARSCAN		; SCAN & EVALUATE VARIABLE
	PUSH	HL
	PUSH	DE
	EX	DE,HL
	LD	E,ERRNUV-ERRN
	JP	NZ,ERRMSG
	LD	(ACCUMLTR),HL
	CALL	TYPECHK
	EX	DE,HL
	LD	HL,ACCUMLTR
	CALL	NZ,COPYVAL
	POP	DE
	POP	HL
	RET

;
;  EVALUATE CONDITIONAL EXPRESSION
;
VALCOND:
	CALL	SCANNXT		; Bscan , EVAL CONDITIONAL EXPRESSION
	CALL	VALNUMBR	; Bscan numbr
	CALL	SCANNXTV	; Bscan (val)
	DEFB	KEYTHEN
	CALL	SIGNACC
	JP	Z,VALCONDF
	CALL	VALEXPR		; Bscan expr  ;TRUE, EVALUATE THEN PORTION
	LD	D,1
VALCNDTL:
	LD	C,KEYEND
	CALL	SCAN2KEY	; SKIP ELSE PORTION
	CALL	SCANNXTV	; Bscan (val)
	DEFB	KEYEND
	DEC	D
	JP	NZ,VALCNDTL
	RET

VALCONDF:
	LD	D,1
VALCNDFL:
	LD	C,KEYELS	; FALSE, SKIP THEN PORTION
	CALL	SCAN2KEY
	CALL	SCANNXTV	; Bscan (val)
	DEFB	KEYELS
	DEC	D
	JP	NZ,VALCNDFL
	CALL	VALEXPR		; Bscan expr  ;EVALUAGE ELSE PORTION
	CALL	SCANNXTV	; Bscan (val)
	DEFB	KEYEND
	RET

;
;  Page 70
;

;
;  EVALUATE INSTRINSIC FUNCTION
;
VALFCTN:
	LD	B,000H		; Scan & EVALUATE INSTRINSIC FUNCTION
	RLCA
	LD	C,A
	PUSH	BC
	CALL	SCANNXT		; Bscan ,
	LD	A,C
	CP	(KEYLFT-KEYFCT)*2-1 ; LEFT$, MID$, OR RIGHT$
	JP	C,VALFCTAR
	CALL	SCANNXTV	; Bscan (val)
	DEFB	'('
	CALL	VALEXPR		; Bscan expr
	CALL	CSTRING
	EX	DE,HL
	LD	HL,(ACCUMLTR)
	EX	(SP),HL		; PUSH STRING ONTO STACK
	JP	VALFCTLK

VALFCTAR:
	CALL	VALPARNS	; EVALUATE ARGUMENT TO FUNCTION
	EX	(SP),HL
	LD	DE,VALRETNM
	PUSH	DE
VALFCTLK:
	LD	BC,FCTTABL	; BRANCH TO APPROPRIATE ROUTINE
	ADD	HL,BC
	LD	C,(HL)
	INC	HL
	LD	H,(HL)
	LD	L,C
	JP	(HL)		; CALL FUNCTION

;
;  Page 71
;

;
;  PROCESS STRING CONSTANT
;
VALSTRGN:
	CALL	ENCODE		; CREATE STRING FROM NUMBER
VALSTRGZ:
	LD	B,080H
	DEC	HL
	JP	VALSTRGY

VALSTRGC:
	LD	B,'"'		; SCAN & DECODE A STRING CONSTANT
VALSTRGY:
	LD	D,B
VALSTRGS:
	PUSH	HL
	LD	C,-1
VALSTRGL:
	INC	HL		; FIND STRING LENGTH
	LD	A,(HL)
	INC	C
	OR	A
	JP	Z,VALSTRGE
	CP	D
	JP	Z,VALSTRGE
	CP	B
	JP	NZ,VALSTRGL
VALSTRGE:
	CP	'"'
	CALL	Z,SCANNXT
	EX	(SP),HL
	INC	HL
	EX	DE,HL
	LD	A,C
	CALL	STRSTCDS
	EX	DE,HL
	CALL	STRGTEST	; LOCATE STRING
	CCF
	RRA
	OR	B
	CALL	P,STRGSTOR	; MAKE COPY OF CERTAIN BUFFERS

;
;  Page 72
;

;
;  ALLOCATE STRING TEMPORARY
;
STRGALOT:
	LD	DE,STRGTMPL	; USE CURRENT DESCRIPTOR
STRGALOU:
	PUSH	DE
	LD	A,TYPESTRG	; RETURN STRING RESULT
	LD	(TYPEFLG),A
	LD	HL,(STRGTMPP)	; IN A NEW STRING TEMPORARY
	LD	(ACCUMLTR),HL
	EX	DE,HL
	LD	HL,(STRGTLIM)	; ANY MORE TEMPORARIES?
	CALL	CMHLLTDE
	JP	C,ERRAST
	EX	DE,HL
	POP	DE		; GET DESCRIPTOR
	CALL	COPYVAL		; COPY IT
	LD	(STRGTMPP),HL
	POP	HL
	RET

STRGALOV:
	PUSH	HL
	JP	STRGALOU

ERRAST:
	LD	E,ERRNST-ERRN
	JP	ERRMSG

;
;  Page 73
;

;
;  RELEASE STRING RESOURCES
;
STRGRELA:
	LD	HL,(ACCUMLTR)
STRGRELH:
	EX	DE,HL
STRGRELD:
	CALL	STRGRELT	; RELEASE TEMPORARY
	EX	DE,HL
	RET	NZ		; NOT OUR BOY
	PUSH	DE
	LD	D,B
	LD	E,C
	DEC	DE
	LD	C,(HL)
	LD	HL,(STRGFREE)
	CALL	CMHLLTDE
	JP	NZ,POPHLRET
	LD	B,A		; RELEASE STRING SPACE
	ADD	HL,BC
	LD	(STRGFREE),HL
	POP	HL
	RET

;
;  RELEASE STRING TEMPORARY
;
STRGRELT:
	LD	HL,(STRGTMPP)	; RELEASE STRING TEMPORARY
	DEC	HL
	LD	B,(HL)
	DEC	HL
	LD	C,(HL)
	DEC	HL
	CALL	CMHLLTDE
	RET	NZ
	LD	(STRGTMPP),HL	; RELEASE STRING TEMPORARY
	RET

;
;  Page 74
;

;
;  EVALUATE A CATENATION
;
VALCONCT:
	PUSH	BC		; EVALUATE A CONCATENATION
	PUSH	HL
	LD	HL,(ACCUMLTR)	; SAVE FIRST OPERAND,
	EX	(SP),HL
	CALL	VALPRMRY	; Bscan prmry  ;EVALUATE SECOND
	EX	(SP),HL
	CALL	CSTRING
	LD	A,(HL)		; ADD LENGTHS,
	PUSH	HL
	LD	HL,(ACCUMLTR)
	PUSH	HL
	ADD	A,(HL)
	LD	E,ERRNLS-ERRN
	JP	C,ERRMSG
	CALL	STRNGEN		; AND ALLOCATE OUTPUT STRING
	POP	DE
	CALL	STRGRELD	; RELEASE STRING TEMPORARIES
	EX	(SP),HL
	CALL	STRGRELH
	PUSH	HL
	LD	HL,(STRGTMPA)	; COPY STRINGS TO OUTPUT STRING
	EX	DE,HL
	CALL	VALCONCP
	CALL	VALCONCP
	LD	HL,VALEXPRD
	EX	(SP),HL
	PUSH	HL
	JP	STRGALOT

VALCONCP:
	POP	HL		; COPY STRING FOR CATENATION
	EX	(SP),HL
	LD	A,(HL)		; GET LENGTH,
	INC	HL
	LD	C,(HL)		; ADDRESS OF STRING
	INC	HL
	LD	B,(HL)
	LD	L,A

COPYSTRG:
	INC	L		; COPY A STRING OF LENGTH L
COPYSTRL:
	DEC	L		; FROM BC TO DE
	RET	Z
	LD	A,(BC)
	LD	(DE),A
	INC	BC
	INC	DE
	JP	COPYSTRL

;
;  Page 75
;

;
;  DIMENSION STATEMENT PROCESSING
;
DIMSTML:
	DEC	HL
	CALL	SCANNXT		; Bscan ,
	RET	Z
	CALL	SCANNXTV	; Bscan (val)
	DEFB	','
DIMSTM:
	LD	BC,DIMSTML	; DIM STATEMENT
	PUSH	BC
	LD	A,080H
	JP	VARSCANI

;
;  SCAN A VARIABLE NAME
;
VARSCAN:
	XOR	A		; SCAN FOR VARIABLE
VARSCANI:
	LD	(MATDMFLG),A
	LD	B,0*TYPEDEF
VARSCNDF:
	CALL	ALPHACHK	; ENTRY TO SCAN FOR DEFINED FCT
	JP	NC,ERRASN
	OR	B
	LD	B,A
	LD	C,'?'
	LD	D,TYPESING	; ASSUME NUMERIC VARIABLE
	CALL	SCANNXT		; Bscan ,
	JP	C,VARSCAND
	CALL	ALPHACHK
	JP	NC,VARSCANS
VARSCAND:
	LD	C,A
VARSKIPL:
	CALL	SCANNXT		; Bscan ,  ;SKIP EXTRA ALPHANUMERIC
	JP	C,VARSKIPL	; CHARACTERS IN NAME
	CALL	ALPHACHK
	JP	C,VARSKIPL
VARSCANS:
	SUB	'$'		; STRING VARIABLE?
	JP	NZ,VARNAME
	LD	D,TYPESTRG	; YES
	CALL	SCANNXT		; Bscan ,

VARNAME:
	LD	A,B		; TRANSLATE IDENT OT INTERNAL FORM
	SUB	'@'		; DEF/VARIABLE IS FIRST BIT
	RLCA			; FIRST CHAR IS NEXT FIVE BITS
	RLCA
	LD	B,A
	LD	A,C		; SECOND CHAR IS NEXT SIX BITS
	SUB	'0'

;
;  Page 76
;

	RRCA
	RRCA
	RRCA
	RRCA
	LD	C,A
	XOR	B		; PACK THREE BYTES INTO TWO
	AND	0003H
	XOR	B
	LD	B,A
	LD	A,D
	LD	(TYPEFLG),A
	XOR	C		; TYPE IS LAST FOUR BITS
	AND	00FH
	XOR	C
	LD	C,A

	LD	A,(SCANPFLG)
	ADD	A,(HL)
	CP	'('		; SUBSCRIPTED?
	JP	Z,MATSCANP
	CP	'['		; BY LEFT BRACKET?
	JP	Z,MATSCANB
	XOR	A
	LD	(SCANPFLG),A
	PUSH	HL

;
;  LOOK UP VARIABLE IN TABLE
;
	LD	HL,(VARTABLE)
VARSCANT:
	EX	DE,HL
	LD	HL,(MATTABLE)
	CALL	CMHLLTDE	; LOOK THROUGH VARIABLE TABLE
	JP	Z,VARSCANF
	LD	A,(DE)
	LD	L,A
	CP	C
	INC	DE
	JP	NZ,VARSCANM
	LD	A,(DE)
	CP	B
VARSCANM:
	INC	DE
	JP	Z,VARSCANX
	LD	A,L
	AND	00FH		; ADDRESS NEXT ENTRY
	LD	L,A
	LD	H,0
	ADD	HL,DE
	JP	VARSCANT

VARSCANF:
	PUSH	BC		; NOT FOUND, CREATE ENTRY
	LD	A,C
	AND	00FH

;
;  Page 77
;

	ADD	A,2
	LD	C,A
	LD	B,0
	EX	DE,HL
	LD	HL,(FREELIMT)
	PUSH	HL
	ADD	HL,BC
	POP	BC
	PUSH	HL
	CALL	COPYCHK		; MOVE ARRAYS FOR SPACE
	POP	HL
	LD	(FREELIMT),HL
	LD	H,B
	LD	L,C
	LD	(MATTABLE),HL	; ALLOCATE, ZERO ENTRY
VARALLOC:
	DEC	HL
	LD	(HL),000H
	CALL	CMHLLTDE
	JP	NZ,VARALLOC
	POP	DE
	LD	(HL),E
	INC	HL
	LD	(HL),D
	INC	HL
	EX	DE,HL		; EXIT VARIABLE SCAN
	OR	E		; NZ=VAR NOT FOUND, CREATED
VARSCANX:
	POP	HL		; HL=SCAN POINTER
	RET

;
;  LOOK UP ARRAY IN TABLE
;
MATSCANB:
	ADD	A,']'-'['+'('-')' ; (got me?)
MATSCANP:
	ADD	A,')'-'('
	PUSH	HL		; SCAN SUBSCRIPT OF VARIABLE
	LD	HL,(MATDMFLG)
	OR	L
	LD	L,A
	EX	(SP),HL		; SAVE DIMFLAG, CLOSE CHAR, TYPE
	LD	D,000H
MATSCANL:
	PUSH	DE		; SCAN SUBSCRIPT LIST
	PUSH	BC
	CALL	SCANNXT		; Scan ,
	CALL	VALINTDE	; EVALUATE SUBSCRIPT
	POP	BC
	POP	AF
	EX	DE,HL
	EX	(SP),HL
	PUSH	HL
	EX	DE,HL
	INC	A		; COUNT NUMBER OF SUBSCRIPTS

;
;  Page 78
;

	LD	D,A
	LD	A,(HL)
	CP	','
	JP	Z,MATSCANL
	EX	(SP),HL
	LD	(MATDMFLG),HL	; RESTORE DIMFLAG, TYPE
	LD	A,L
	POP	HL
	XOR	(HL)
	ADD	A,A		; CHECK FOR CORRECT CLOSER
	JP	NZ,ERRASN
	LD	(SCANPTR2),HL
	PUSH	DE
	LD	HL,(MATTABLE)	; LOOK FOR NAME IN
	JP	MATSCANO	; MAT VARIABLE TABLE
MATSCANN:
	ADD	HL,DE
MATSCANO:
	EX	DE,HL
	LD	HL,(FREELIMT)
	EX	DE,HL
	CALL	CMHLLTDE
	JP	Z,MATSCANC
	LD	A,(HL)
	CP	C
	INC	HL
	JP	NZ,MATSCANM
	LD	A,(HL)
	CP	B
MATSCANM:
	INC	HL
	LD	E,(HL)
	INC	HL
	LD	D,(HL)
	INC	HL
	JP	NZ,MATSCANN
	LD	A,(MATDMFLG)	; NAME FOUND
	OR	A
	LD	E,ERRNDD-ERRN
	JP	M,ERRMSG
	POP	AF		; RIGHT NUMBER OF SUBSCRIPTS?
	CP	(HL)
	JP	Z,MATSCANI
ERRABS:
	LD	E,ERRNBS-ERRN
	JP	ERRMSG

MATSCANC:
	LD	A,C		; NAME NOT FOUND, CREATE NEW ENTRY
	AND	00FH
	LD	E,A
	LD	D,0
	LD	(HL),C
	INC	HL
	LD	(HL),B
	INC	HL

;
;  Page 79
;

	POP	AF
	LD	(MATSCCNT),A
	LD	C,A
	CALL	SPACESTK
	LD	(SCANPTR1),HL
	INC	HL
	INC	HL		; Plus 2
	LD	B,C
	LD	(HL),B
	INC	HL
MATSCNSB:
	LD	A,(MATDMFLG)	; SET SUBSCRIPT RANGES
	OR	A
	LD	A,B
	LD	BC,11		; DEFAULT RANGE=0-10
	JP	P,MATSCNSD
	POP	BC
	INC	BC
MATSCNSD:
	LD	(HL),C
	INC	HL
	LD	(HL),B
	INC	HL
	PUSH	AF
	PUSH	HL
	CALL	MUL16		; UPDATE ARRAY SIZE
	EX	DE,HL
	POP	HL
	POP	BC
	DEC	B
	JP	NZ,MATSCNSB
	LD	B,D
	LD	C,E
	EX	DE,HL		; ALLOCATE ARRAY,
	ADD	HL,DE
	JP	C,ERRABS
	CALL	SPACECHK
	LD	(FREELIMT),HL
MATSCANZ:
	DEC	HL		; AND ZERO
	LD	(HL),000H
	CALL	CMHLLTDE
	JP	NZ,MATSCANZ
	INC	BC		; SAVE ENTRY SIZE
	LD	H,A
	LD	A,(MATDMFLG)
	OR	A
	LD	A,(MATSCCNT)
	LD	L,A
	ADD	HL,HL
	ADD	HL,BC
	EX	DE,HL
	LD	HL,(SCANPTR1)	; AT BEGINNING OF ENTRY
	LD	(HL),E
	INC	HL
	LD	(HL),D

;
;  Page 80
;

	INC	HL
	JP	M,MATSCANX	; DIM ONLY?
MATSCANI:
	INC	HL		; INITIALIZE SUBSCRIPT COMPUTATION
	LD	BC,0
	JP	MATSCANS
MATSCANR:
	POP	HL		; COMPUTE SPECIFIC REFERENCE
MATSCANS:
	LD	E,(HL)
	INC	HL
	LD	D,(HL)
	INC	HL
	EX	(SP),HL
	PUSH	AF
	CALL	CMHLLTDE
	JP	NC,ERRABS
	PUSH	HL
	CALL	MUL16
	POP	DE
	ADD	HL,DE
	POP	AF
	DEC	A
	LD	B,H
	LD	C,L
	JP	NZ,MATSCANR
	LD	A,(TYPEFLG)
	LD	E,A
	LD	D,0
	CALL	MUL16		; MULTIPLY BY ENTRY SIZE
	POP	BC
	ADD	HL,BC
	EX	DE,HL
MATSCANX:
	LD	HL,(SCANPTR2)
	CALL	SCANNXT		; Bscan ,
	CP	A
	RET

MUL16:
	LD	HL,0		; MULTIPLY BC*DE GIVING HL
	LD	A,B
	OR	C
	RET	Z
	LD	A,16
MUL16LP:
	ADD	HL,HL
	JP	C,ERRABS
	EX	DE,HL
	ADD	HL,HL
	EX	DE,HL
	JP	NC,MUL16XT
	ADD	HL,BC
	JP	C,ERRABS
MUL16XT:
	DEC	A

;
;  Page 81
;

	JP	NZ,MUL16LP
	RET

;
;  Page 82
;

;
;  USER-DEFINED FUNCTION DEFINITION
;
DEFSTM:
	CALL	SCANFNN		; DEF STATEMENT
	PUSH	HL		; CHECK IF IN DIRECT MODE
	LD	HL,(CURLINE)	; Z=DIRECT MODE
	INC	HL
	LD	A,H
	OR	L
	POP	HL
	JP	Z,ERRAID
	EX	DE,HL		; SAVE REFERENCE TO DEFINITION
	LD	(HL),E
	INC	HL
	LD	(HL),D
	EX	DE,HL
	LD	A,(HL)
	CP	'('		; CHECK FOR VARLIST
DEFSTML:
	JP	NZ,DATSTM
	CALL	SCANNXT		; Bscan ,
	CALL	VARSCAN		; DEFINE VARIABLES IN LIST
	LD	A,(HL)
	CP	','
	JP	DEFSTML

;  USER-DEFINED FUNCTION EVALUATION
;
VALFCTD:
	CALL	SCANFNN		; SCAN & EVALUATE USER DEFINED FUNCTION
	LD	A,(TYPEFLG)	; SAVE TYPE OF FUNCTION
	OR	A
	PUSH	AF
	PUSH	HL		; SAVE CALL ARGUMENTS
	EX	DE,HL
	LD	A,(HL)
	INC	HL
	LD	H,(HL)		; FETCH FUNCTION DEFINITION
	LD	L,A
	OR	H
	LD	E,ERRNUF-ERRN
	JP	Z,ERRMSG	; MUST BE DEFINED ...

;
;  Page 83
;

	LD	A,(HL)
	CP	'('		; PARAMETERS NEEDED?
	JP	NZ,VALFCTNA	; APPARENTLY NOT
	CALL	SCANNXT		; Bscan ,
	EX	(SP),HL
	CALL	SCANNXTV	; Bscan (val)
	DEFB	'('		; MUST BE PARAMETERS IN CALL
	EX	(SP),HL
	JP	VALFCTDM

;  ARGUMENT SCANNING
;
VALFCTDL:
	CALL	SCANNXTV	; Bscan (val)
	DEFB	','		; COMMAS BETWEEN ARGUMENTS
	EX	(SP),HL
	CALL	SCANNXTV	; Bscan (val)
	DEFB	','		; AND BETWEEN PARAMETERS
VALFCTDM:
	LD	C,4		; VERIFY SPACE ON STACK
	CALL	SPACESTK
	LD	A,SCANPFLD	; SCAN NEXT PARAMETER
	LD	(SCANPFLG),A
	CALL	VALVAR		; GET CURRENT VALUE OF PARAMETER
	LD	(SCANPTR1),HL	; SAVE PARAMETER SCAN
	POP	HL
	LD	(SCANPTR2),HL	; SAVE ARGUMENT SCAN
	CALL	TYPECHK
	JP	Z,VALFCTPS	; PUSH STRINGS DIFFERENTLY
	CALL	PUSHAC1		; PUSH NUMERIC ACCUMULATOR
	PUSH	HL		; SAVE VARIABLE'S ADDRESS
	JP	VALFCTPT
VALFCTPS:
	CALL	STRGALOV	; COPY DESCRIPTOR TO TEMPORARY
	XOR	A		; ELIMINATE ORIGINAL DESCRIPTOR
	DEC	DE
	DEC	DE
	DEC	DE		; Plus 3
	LD	(DE),A
	LD	HL,(ACCUMLTR)	; GET ADDRESS OF DESCRIPTOR
	PUSH	HL
	PUSH	DE		; PUT IT BACK HERE LATER

;
;  Page 84
;
VALFCTPT:
	LD	A,(TYPEFLG)	; SAVE TYPE OF PARAMETER
	SCF
	POP	DE
	PUSH	DE		; GET COPY OF ADDRESS
	PUSH	AF
	LD	HL,(SCANPTR1)	; SAVE PARAMETER SCAN
	PUSH	HL
	LD	HL,(SCANPTR2)
	CALL	ASSIGNVL	; UPDATE VALUE OF PARAMETER
	LD	A,(HL)
	CP	')'
	JP	NZ,VALFCTDL	; MORE ARGUMENTS
	CALL	SCANNXT		; Bscan (val)
	EX	(SP),HL
	CALL	SCANNXTV	; Bcscan (val)
	DEFB	')'		; MUST BE END OF PARAMETERS TOO

;  EVALUATE EXPRESSION
;
VALFCTNA:
	CALL	SCANNXTV	; Bscan (val)
	DEFB	KEYEQ		; LOOK FOR EQUALS SIGN
	CALL	VALEXPR		; Bscan expr  ;EVALUATE FUNCTION
	DEC	HL
	CALL	SCANNXT		; Bscan ,
	JP	NZ,ERRASN
	POP	HL
	LD	(SCANPTR1),HL
	CALL	TYPECHK
	JP	NZ,VALFCTRL
	CALL	STRGUNIQ
	EX	DE,HL
	LD	(ACCUMLTR),HL

;
;  Page 85
;

;  RESTORE PARAMETERS
;
VALFCTRL:
	POP	AF		; RESTORE VALUES OF PARAMETERS
	JP	NC,VALFCTCR
	POP	HL
	CALL	TYPECHKA
	JP	Z,VALFCTRS
	POP	BC
	POP	DE
	LD	(HL),E		; RESTORE NUMERIC VALUE
	INC	HL
	LD	(HL),D
	INC	HL
	LD	(HL),C
	INC	HL
	LD	(HL),B
	JP	VALFCTRL
VALFCTRS:
	POP	DE		; RESTORE STRING VALUE
	EX	DE,HL
	LD	(STRGTMPP),HL	; DEALLOCATE TEMPORARY
	EX	DE,HL
	LD	B,TYPESTRG
	CALL	COPYVALL
	JP	VALFCTRL

VALFCTCR:
	LD	HL,(SCANPTR1)	; COERCE RESULT TO CORRECT TYPE
	CALL	TYPECHKA
	JP	NZ,COERCEF
	CALL	CSTRING		; STRING FUNCTION
	PUSH	HL
	LD	HL,(ACCUMLTR)
	EX	DE,HL
	CALL	STRGRELT
	JP	STRGALOU

ERRAID:
	LD	E,ERRNID-ERRN
	JP	ERRMSG

SCANFNN:
	CALL	SCANNXTV	; Bscan (val)
	DEFB	KEYFN
	LD	A,SCANPFLD
	LD	(SCANPFLG),A
	LD	B,TYPEDEF
	JP	VARSCNDF

;
;  Page 86
;

;
;  GENERATE A NEW CURRENT STRING
;
STRNGEN:
	CALL	STRGALOC	; GENERATE A NEW STRING,
STRSTCDS:
	LD	HL,STRGTMPL	; SET CURRENT STRING DESCRIPTOR
	PUSH	HL
	LD	(HL),A
	INC	HL
	LD	(HL),E
	INC	HL
	LD	(HL),D
	POP	HL
	RET

;
;  ALLOCATE STORAGE IN STRING SPACE
;
STRGALOC:
	OR	A		; ALLOCATE SPACE FOR STRING,
	JP	STRGALAH	; SIZE IN A
STRGALAG:
	POP	AF		; ENTER FOR SECOND TRY
STRGALAH:
	PUSH	AF
	LD	HL,(STCKBASE)
	EX	DE,HL
	LD	HL,(STRGFREE)
	CPL
	LD	C,A
	LD	B,0FFH
	ADD	HL,BC
	INC	HL
	CALL	CMHLLTDE
	JP	C,STRGALGC
	LD	(STRGFREE),HL
	INC	HL
	EX	DE,HL		; RETURNS:  DE=STRING ADDRESS
POPAFRET:
	POP	AF
	RET

STRGALGC:
	POP	AF		; COLLECT GARBAGE IN STRING SPACE
	LD	E,ERRNOS-ERRN
	JP	Z,ERRMSG
	CP	A
	PUSH	AF
	LD	BC,STRGALAG	; THEN TRY ALLOCATION
	PUSH	BC

;
;  Page 87
;

;
;  COLLECT GARBAGE IN STRING SPACE
;
STRGGBCL:
	LD	HL,(STRGBASE)	; MAKE ALL STRINGS UNSAFE
STRGGBLP:
	LD	(STRGFREE),HL	; FIND HIGHEST UNSAFE STRING
	LD	HL,0
	PUSH	HL
	LD	HL,(STCKBASE)
	PUSH	HL
	LD	HL,(STRGBASE)	; SCAN TEMPORARIES,
	INC	HL
STRGGBTL:
	EX	DE,HL
	LD	HL,(STRGTMPP)
	EX	DE,HL
	CALL	CMHLLTDE
	LD	BC,STRGGBTL
	JP	NZ,STRGGBHI
	LD	HL,(VARTABLE)	; SCAN REGULAR VARIABLES,
STRGGBVR:
	EX	DE,HL
	LD	HL,(MATTABLE)
	EX	DE,HL
	CALL	CMHLLTDE
	JP	Z,STRGGNAV
	LD	A,(HL)
	INC	HL
	AND	00FH
	SUB	TYPESTRG
	LD	E,A
	SBC	A,A
	LD	D,A
	LD	A,(HL)
	INC	HL
	AND	080H		; DEFINITIONS ARE STRINGS
	ADD	HL,DE
	OR	E
	CALL	STRGGBHV
	JP	STRGGBVR

STRGGBAL:
	POP	BC
STRGGNAV:
	EX	DE,HL		; SCAN ARRAY VARIABLES
	LD	HL,(FREELIMT)
	EX	DE,HL
	CALL	CMHLLTDE
	JP	Z,STRGGBMV
	CALL	LDRGMM
	LD	A,E
	PUSH	HL
	ADD	HL,BC
	AND	00FH

;
;  Page 88
;

	CP	TYPESTRG
	JP	NZ,STRGGBAL
	LD	(SCANPTR1),HL
	POP	HL
	LD	C,(HL)
	LD	B,000H
	ADD	HL,BC
	ADD	HL,BC
	INC	HL
STRGGBAS:
	EX	DE,HL		; LOOK THROUGH ENTIRE ARRAY
	LD	HL,(SCANPTR1)
	EX	DE,HL
	CALL	CMHLLTDE
	JP	Z,STRGGNAV
	LD	BC,STRGGBAS
STRGGBHI:
	PUSH	BC		; COMPARE THIS STRING ADDR TO MAX
	XOR	A
STRGGBHV:
	LD	C,(HL)		; LOAD STRING DESCRIPTOR
	INC	HL
	LD	E,(HL)
	INC	HL
	LD	D,(HL)
	INC	HL
	RET	NZ		; NOT A STRING VARIABLE
	LD	A,C
	OR	A		; CHECK FOR ZERO LENGTH
	RET	Z
	LD	B,H		; ALREADY SAFE?
	LD	C,L
	LD	HL,(STRGFREE)
	CALL	CMHLLTDE
	LD	H,B
	LD	L,C
	RET	C
	POP	HL		; COMPARE WITH HIGHEST UNSAFE
	EX	(SP),HL
	CALL	CMHLLTDE
	EX	(SP),HL
	PUSH	HL
	LD	H,B
	LD	L,C
	RET	NC
	POP	BC		; SAVE NEW HIGHEST UNSAFE ADDR
	POP	AF
	POP	AF
	PUSH	HL
	PUSH	DE
	PUSH	BC
	RET

;
;  Page 89
;

STRGGBMV:
	POP	DE		; MAKE HIGHEST UNSAFE SAFE
	POP	HL
	LD	A,L
	OR	H
	RET	Z		; ANY UNSAFE?
	DEC	HL		; LOAD DESCRIPTOR
	LD	B,(HL)
	DEC	HL
	LD	C,(HL)
	PUSH	HL
	DEC	HL
	LD	L,(HL)		; FIND END OF STRING
	LD	H,000H
	ADD	HL,BC
	LD	D,B
	LD	E,C
	DEC	HL
	LD	B,H
	LD	C,L
	LD	HL,(STRGFREE)	; COPY IT TO END OF SAFE AREA
	CALL	COPYTEXT
	POP	HL
	LD	(HL),C
	INC	HL
	LD	(HL),B
	LD	H,B
	LD	L,C
	DEC	HL
	JP	STRGGBLP	; EXTEND SAFE AREA

;
;  Page 90
;

;
;  VARIOUS NUMERIC/STRING CONVERSION FUNCTIONS
;

;
;  FIND LENGTH OF STRING
;
LENFCT:
	LD	BC,FLOATA	; LEN FUNCTION
	PUSH	BC
LENFCTC:
	CALL	CSTRING
	CALL	STRGRELA
	LD	A,TYPESING
	LD	(TYPEFLG),A
	LD	A,(HL)
	OR	A
	INC	HL
	RET

;
;  CONVERT CHARACTER TO BYTE
;
ASCFCT:
	CALL	LENFCTC		; ASC FUNCTION
	JP	Z,ERRAFC
	LD	C,(HL)		; FETCH ADDRESS
	INC	HL
	LD	B,(HL)
	LD	A,(BC)		; THEN THE FIRST CHARACTER
	JP	FLOATA

;
;  CONVERT BYTE TO CHARACTER
;
CHRFCT:
	LD	A,1		; CHR$ FUNCTION
	CALL	STRNGEN
	CALL	CBYTE
	LD	HL,(STRGTMPA)
	LD	(HL),E
VALRETST:
	POP	BC		; STRING FUNCTION, REMOVE CSINGLE
	JP	STRGALOT

;
;  Page 91
;

;
;  DECODE NUMBER FROM STRING
;
VALFCT:
	CALL	LENFCTC		; VAL FUNCTION
	JP	Z,ZEROAC
	LD	E,A
	LD	D,0
	LD	C,(HL)
	INC	HL
	LD	B,(HL)
	PUSH	BC
	LD	H,B
	LD	L,C
	ADD	HL,DE
	LD	B,(HL)
	LD	(HL),D
	EX	(SP),HL
	PUSH	BC
	LD	A,(HL)
	CALL	DECODE
	POP	BC
	POP	HL
	LD	(HL),B
	RET

;
;  ENCODE NUMBER IN STRING
;
STRFCT:
	CALL	CSINGLE		; STR$ FUNCTION
	CALL	VALSTRGN	; CREATE STRING FROM NUMBER
	CALL	STRGRELA
	LD	BC,VALRETST
	PUSH	BC
	EX	DE,HL
STRGSTOR:
	EX	DE,HL
	LD	A,(HL)		; STORE STRING INTO STRING SPACE,
	PUSH	HL		; LEAVE DESCRIPTOR IN STRGTMP
	CALL	STRGALOC
	POP	HL
	CALL	LDICBMM		; LOAD BUFFER ADDRESS
	CALL	STRSTCDS
	PUSH	HL
	LD	L,A
	CALL	COPYSTRG
POPDERET:
	POP	DE
	RET

;
;  Page 92
;

;
;  CONVERT HEX STRING TO NUMBER
;
HXVFCT:
	CALL	LENFCTC		; DO INITIAL PROCESSING
	JP	Z,ZEROAC
	LD	E,A
	LD	C,(HL)
	INC	HL
	LD	B,(HL)
	LD	HL,0		; INITIAL OUTPUT TO ZERO
HXVFCTL:
	LD	A,(BC)		; FETCH CHARACTER
	INC	BC
	CP	':'		;  VERIFY THAT IT'S HEX
	CALL	NC,HXVFCTCH
	JP	NC,ERRAFC	; IF NOT, COMPLAIN
	SUB	'0'
	JP	C,ERRAFC	; MUST BE AT LEAST ZERO
	ADD	HL,HL
	ADD	HL,HL		; INCORPORATE NEW DIGIT
	ADD	HL,HL
	ADD	HL,HL
	OR	L
	LD	L,A
	DEC	E		; COUNT DIGITS
	JP	NZ,HXVFCTL
FLOATHL:
	LD	A,H		; CONVERT INTEGER IN HL TO FLOAT
	LD	B,L
	JP	FLOATAB

HXVFCTCH:
	CALL	ALPHACHA	; CONVERT ANY ALPHA TO UPPER
	RET	NC
	SUB	'A'-'9'-1	; MOVE ALPHA TO AFTER DIGITS
	CP	'0'+16		; SET FLAGS CORRECTLY
	RET

;
;  Page 93
;

;
;  CONVERT BYTE TO TWO HEX CHARACTERS
;
HEXFCT:
	LD	A,2		; ALLOCATE OUTPUT STRING
	CALL	STRNGEN
	LD	A,(FLACCEXP)
	CALL	FIXAC		; GET INPUT BYTE
	LD	HL,VALRETST
	PUSH	HL
	LD	HL,(STRGTMPA)
	CALL	HEXFCTL
HEXFCTL:
	LD	A,E		; CONVERT ONE DIGIT
	RLCA
	RLCA
	RLCA
	RLCA
	LD	E,A
	AND	00FH
	CP	10
	CCF			; COVERT TO CHARACTER FORM
	ADC	A,'0'
	DAA
	LD	(HL),A
	INC	HL
	RET

;
;  TRANSLATE STRING TO UPPER CASE
;
UPRFCT:
	CALL	CSTRING
	LD	HL,(ACCUMLTR)	; GET LENGTH OF OPERAND
	PUSH	HL
	LD	A,(HL)
	CALL	STRNGEN		; ALLOCATE OUTPUT STRING
	POP	DE
	CALL	STRGRELD	; RELEASE INPUT STRING
	CALL	LDDCBMM
	LD	HL,(STRGTMPA)
	INC	D
UPRFCTL:
	DEC	D		; TRANSLATE WHILE COPYING
	JP	Z,VALRETST	; DONE
	LD	A,(BC)
	CALL	ALPHACHA	; CONVER LOWER TO UPPER
	LD	(HL),A
	INC	BC
	INC	HL
	JP	UPRFCTL

;
;  Page 94
;

;
;  SUBSTRING FUNCTIONS
;
LFTFCT:
	CALL	LEFRIGAR	; LEFT$ FUNCTION
	XOR	A		; LEFT(X,N)=MID(X,1,N)
LEFRIGMR:
	EX	(SP),HL
	LD	C,A		; C=START-1, B=LEN
LEFRIGMD:
	PUSH	HL		; RESOLVE DESIRED LEN WITH STRING
	LD	A,(HL)
	CP	B
	JP	C,LEFRIGMC
	LD	A,B
	JP	LEFRIGMB

LEFRIGAR:
	EX	DE,HL		; INITIAL COMMON PROCESSING
	CALL	VALBYTE2	; FOR LEFT$, RIGHT$
	LD	B,E
	CALL	SCANNXTV	; Bscan (val)
	DEFB	')'
	RET

LEFRIGMC:
	LD	C,0
LEFRIGMB:
	PUSH	BC
	CALL	STRGALOC	; ALLOCATE ANSWER STRING
	POP	BC
	POP	HL
	PUSH	HL
	INC	HL
	LD	B,(HL)		; COMPUTE ADDRESSES FOR COPY
	INC	HL
	LD	H,(HL)
	LD	L,B		; (from HL,MB)
	LD	B,0
	ADD	HL,BC
	LD	B,H
	LD	C,L
	CALL	STRSTCDS
	LD	L,A
	CALL	COPYSTRG	; COPY
	POP	DE
	CALL	STRGRELD
	JP	STRGALOT

;
;  Page 95
;

RIGFCT:
	CALL	LEFRIGAR	; RIGHT$ FUNCTION
	POP	DE
	PUSH	DE
	LD	A,(DE)
	SUB	B		; RIGHT(X,N)=MID(X,LEN(X)-N+1,N)
	JP	LEFRIGMR

MIDFCT:
	EX	DE,HL		; MID$ FUNCTION
	CALL	VALBYTE2	; SCAN STARTING POSITION
	LD	B,E
	OR	A		; NON-ZERO STARTING POSITION?
	JP	Z,ERRAFC
	PUSH	BC
	LD	E,0FFH
	LD	A,(HL)
	CP	')'
	CALL	NZ,VALBYTE2	; SCAN OPTIONAL THIRD ARGUMENT
	CALL	SCANNXTV	; Bscan (val)
	DEFB	')'
	POP	AF		; COMPUTE STARTING BYTE AND LENGTH
	EX	(SP),HL
	LD	BC,LEFRIGMD
	PUSH	BC
	DEC	A
	CP	(HL)
	LD	B,0		; START > LENI => LENO=0
	RET	NC
	LD	C,A
	LD	A,(HL)
	SUB	C
	CP	E
	LD	B,A
	RET	C		; LEN0 = MIN(LENI-START,LENR)
	LD	B,E
	RET

;
;  Page 96
;

;
;  INDEX OF STRING FUNCTION
;
INSFCT:
	EX	DE,HL
	CALL	SCANNXTV	; Bscan (val)
	DEFB	','
	CALL	VALPARN2	; SCAN SECOND ARGUMENT
	EX	(SP),HL		; SHUFFLE RETURN STACK
	LD	BC,POPHLRET
	PUSH	BC
	PUSH	HL
	CALL	LENFCTC		; PROCESS  SECOND STRING
	EX	(SP),HL
	PUSH	AF
	JP	Z,INSFCTXT
	CALL	STRGRELH	; WORK ON FIRST STRING
	LD	A,(HL)
	POP	BC
	POP	DE
	SUB	B		; COMPARE LENGTHS
	JP	C,ZEROAC	; TEST IS LONGER, NO MATCHES
	INC	A
	LD	C,A		; SAVE NUMBER OF ATTEMPTS
	PUSH	BC
	CALL	LDICBMM		; GET ADDRESS OF TARGET
	EX	DE,HL
	LD	E,(HL)		; GET ADDRESS OF MATCHER
	INC	HL
	LD	D,(HL)
	EX	DE,HL
	POP	DE		; RECOVER LENGTH, COUNTER
	LD	A,1
INSFCTSL:
	PUSH	DE		; SAVE LENGTH, COUNTER
	PUSH	AF		; SAVE POSITION
	PUSH	BC		; SAVE ADDRESSES
	PUSH	HL
	LD	E,D
	CALL	RELOPRSL	; COMPARE STRINGS
	POP	HL		; RECOVER ADDRESSES
	POP	BC
INSFCTXT:
	POP	DE
	LD	A,D		; RECOVER POSITION
	POP	DE		; AND LENGTH, COUNTER
	JP	Z,FLOATA	; ANSWER FOUND, GIVE IT BACK
	INC	A		; INCREMENT POSITION
	INC	BC
	DEC	E		; COUNT ATTEMPTS
	JP	NZ,INSFCTSL	; KEEP TRYING
	JP	ZEROAC		; OR NOMATCH

;
;  Page 97
;

;
;  FUNCTION RETURNING AMOUNT OF REMAINING FREE SPACE
;
FREFCT:
	LD	HL,(MATTABLE)	; FRE FUNCTION
	EX	DE,HL
	LD	HL,0
	ADD	HL,SP
	CALL	TYPECHK
	JP	NZ,FREFCTNS
	CALL	STRGRELA	; RETURN BYTES OF FREE STRNG SPACE
	CALL	STRGGBCL
	LD	HL,(STCKBASE)
	EX	DE,HL
	LD	HL,(STRGFREE)
FREFCTNS:
	LD	A,L
	SUB	E
	LD	B,A
	LD	A,H
	SBC	A,D
FLOATAB:
	LD	D,B
	LD	E,000H
	LD	HL,TYPEFLG
	LD	(HL),TYPESING
	LD	B,090H
	JP	FLOATINT

;
;  MEMORY DIDDLING FACILITIES
;
MEMFCT:
	CALL	TYPECHK		; MEM FUNCTION
	JP	Z,MEMFCTC
	CALL	CINTEGER
	LD	A,(DE)
	JP	FLOATA
MEMFCTC:
	CALL	LENFCTC		; RELEASE ARGUMENT
	LD	HL,(PROGBASE)
	JP	Z,FLOATHL	; ZERO LENGTH STRING=PROGBASE
	LD	HL,(STRGTLIM)
	JP	FLOATHL		; OTHERWISE=UPPER LIMIT

MEMSTM:
	CALL	SCANNXT		; Bscan +  ;MEM STATEMENT
	CALL	VALPARNS
	CALL	CINTEGER
	PUSH	DE
	CALL	SCANNXTV	; Bscan (val)
	DEFB	KEYEQ
	CALL	VALBYTE
	POP	DE
	LD	(DE),A

;
;  Page 98
;

	RET

;
;  Page 99
;

;
;  DIRECT I/O FACILITIES
;

PORFCT:
	CALL	CBYTE		; PORT FUNCTION
	LD	D,OPCINP
	CALL	INOTGEN
	CALL	INOTINS
	JP	FLOATA

PORSTM:
	CALL	SCANNXT		; Bscan +  ;PORT STATEMENT
	CALL	VALPARNS
	CALL	CBYTE
	PUSH	DE
	CALL	SCANNXTV	; Bscan (val)
	DEFB	KEYEQ
	CALL	VALBYTE
	POP	DE
	LD	D,OPCOUT
	CALL	INOTGEN
	JP	INOTINS

WAISTM:
	CALL	VALBYTE		; WAIT STATEMENT
	PUSH	DE
	CALL	VALBYTE2
	PUSH	AF
	LD	E,0
	CALL	NZ,VALBYTE2
	POP	BC
	LD	C,E
	POP	DE
	LD	D,OPCINP
	CALL	INOTGEN
WAISTMIN:
	CALL	SYSWAIT		; DO A SYSTEM WAIT
	CALL	INOTINS		; THEN CHECK DEVICE
	XOR	C
	AND	B
	JP	Z,WAISTMIN
	RET

INOTGEN:
	PUSH	HL		; GENERATE INPUT/OUTPUT FOLLOWED
	LD	HL,INOTINS	; BY RETURN
	LD	(HL),D
	INC	HL
	LD	(HL),E
	INC	HL
	LD	(HL),OPCRET
	POP	HL
	RET

;
;  Page 100
;

;
;  CSAVE/CLOAD ROCESSORS
;    save filename - save on diskette
;    load filename - get from diskette
;
;  load and save programs from the disk
;
D14BASE EQU	0B400H
FSPROM	EQU	0B000H
BOOTSTART EQU	FSPROM+39BH	; Load image files
DIRECTORYLOOKUP EQU	D14BASE+4E0H ; Find filename
OPENS	EQU	D14BASE+396H	; Open stream
PUTS	EQU	D14BASE+3DCH	; Put char
CLOSES	EQU	D14BASE+42DH	; Close stream
;
CLDSTM:
	CALL	SETFILENAME	; Parse filename
	CALL	DIRECTORYLOOKUP
	JP	NC,NAMENOTFOUND
	CALL	BOOTSTART
	CALL	CHECKPROGRAM
	CALL	NEWLOAD		; Reset program pointers
	JP	CMNDSTRT
NAMENOTFOUND:
	LD	E,ERRNFI-ERRN	; File not saved
	JP	ERRMSG


CSVSTM:
	CALL	SETFILENAME
	LD	B,2		; Write enable
	CALL	OPENS		; Open stream (only one in D14)
	JP	NC,CANNOTOPEN	; -disk full or other bad stuff
	CALL	CHECKPROGRAM
	PUSH	HL		; Save end pointer
	LD	HL,(PROGBASE)	; First address
	LD	C,L
	CALL	PUTS
	LD	C,H
	CALL	PUTS
	LD	C,0		; Start address = 0 for no start
	CALL	PUTS
	CALL	PUTS
	POP	DE		; De has end address=1
SAVELOOP:
	LD	C,(HL)		; Get char
	INC	HL
	CALL	PUTS		; And send t file
	LD	A,H		; Is this the end?
	CP	D
	JP	NZ,SAVELOOP
	LD	A,L
	CP	E
	JP	NZ,SAVELOOP
	CALL	CLOSES		; Yes

;
;  Page 101
;

	JP	CMNDSTRT
CANNOTOPEN:
	LD	E,ERRNSL-ERRN
	JP	ERRMSG


;  setfilename
;    returns hl set to a filename string
;
SETFILENAME:
	LD	DE,FILENAME+1
	LD	B,0
SFNLOOP:
	LD	A,(HL)		; Look at char
	CP	0
	JP	Z,SFNDONE
	CP	' '
	JP	Z,SFNDONE
	INC	B		; Up count
	INC	HL
	LD	(DE),A
	INC	DE
	JP	SFNLOOP
SFNDONE:
	LD	HL,FILENAME
	XOR	A		; Is the name non zero
	OR	B
	JP	Z,ERRASN	; Yes
	LD	(HL),A		; Store count
	RET


;  checkprogram
;    walk over the program looking for the end
;    return last byte+1 in hl
;
CHECKPROGRAM:
	LD	HL,(PROGBASE)	; Starts here
CPROGLOOP:
	LD	A,(HL)		; Pick up line length
	INC	HL
	OR	(HL)
	INC	HL
	JP	Z,CPROGOK	; If zero then all done
	INC	HL
	INC	HL		; Skip line number
CPROGLOOP2:
	LD	A,(HL)
	OR	A
	INC	HL
	JP	Z,CPROGLOOP	; Zero at the end of the line
	JP	CPROGLOOP2
CPROGOK:
	RET
FILENAME:
	DEFS	60

;
;  Page 102
;

;
;  LOGICAL OPERATORS
;


ORNOPR:
	OR	A		; OR OPERATOR
	JP	LOGOPRIC
ANDOPR:
	XOR	A		; AND OPERATOR
LOGOPRIC:
	PUSH	AF
	CALL	CSINGLE
	CALL	CINTEGER
	POP	AF
	EX	DE,HL
	POP	BC
	EX	(SP),HL
	EX	DE,HL
	CALL	LDACRG
	PUSH	AF
	CALL	CINTEGER
	POP	AF
	POP	BC
	LD	A,C
	JP	NZ,ORNOPRFN
	AND	E
	LD	C,A
	LD	A,B
	AND	D
	JP	LOGOPRXT	; RETURN FROM AND

ORNOPRFN:
	OR	E
	LD	C,A
	LD	A,B
	OR	D
LOGOPRXT:
	LD	B,C
	JP	FLOATAB		; RETURN FROM OR

VALUNOT:
	LD	D,PREDNOT	; EVALUATE UNARY NOT
	CALL	VALEXPRL
	CALL	CSINGLE
	CALL	CINTEGER
	LD	A,E
	CPL
	LD	C,A
	LD	A,D
	CPL
	CALL	LOGOPRXT
	POP	BC
	JP	VALEXPRC

;
;  Page 103
;

;
;  MOD, MAXIMUM, MINIMUM OPERATORS
;


MODOPR:
	POP	BC		; MODULO FUNCTION
	POP	DE		; X MOD Y =
	PUSH	DE		; X - INT(X/Y) * Y
	PUSH	BC
	LD	HL,(ACCUMLTR)
	PUSH	HL
	LD	HL,(FLACCMSB)
	PUSH	HL
	CALL	FLDIV
	CALL	INTFCT
	POP	BC
	POP	DE
	CALL	FLMUL
	JP	SUBOPR

MAXOPR:
	POP	BC
	POP	DE
	CALL	FLCMP		; COMPARE OPERANDS
	RET	Z		; NO DIFFERENCE
	JP	C,LDACRG	; REGISTERS LARGER
	JP	LDRGAC		; ACUMULATOR LARGER

MINOPR:
	POP	BC
	POP	DE
	CALL	FLCMP		; COMPARE OPERANDS
	RET	Z		; NO DIFFERENCE
	JP	NC,LDACRG	; REGISTERS SMALLER
	JP	LDRGAC		; ACCUMULATOR SMALLER

;
;  Page 104
;

;
;  FLOATING POINT ADD/SUBTRACT ROUTINES
;


FLADDHLF:
	LD	HL,FLHALF
FLADDM:
	CALL	LDRGMM
	JP	FLADD

FLMMMAC:
	CALL	LDRGMM		; COMPUTE MM-AC
	JP	FLSUB

SUBOPR:
	POP	BC
	POP	DE
FLSUB:
	CALL	CMACCS		; SUBTRACT ACC FROM REGISTERS
FLADD:
	LD	A,B		; ADD ACCUMULATOR TO REGISTERS
	OR	A
	RET	Z
	LD	A,(FLACCEXP)
	OR	A
	JP	Z,LDACRG
	SUB	B
	JP	NC,FLADDMGC
	CPL			; NEED LARGER IN AC, INTERCHANGE
	INC	A
	EX	DE,HL
	CALL	PUSHAC
	EX	DE,HL
	CALL	LDACRG
	POP	BC
	POP	DE
FLADDMGC:
	CP	019H		; ARE MAGNITUDES ARE COMMENSURATE?
	RET	NC
	PUSH	AF
	CALL	SIGNIFY
	LD	H,A
	POP	AF
	CALL	SHIFTR0
	OR	H
	LD	HL,ACCUMLTR
	JP	P,FLADDIFF
	CALL	ADDM2CDE
	JP	NC,FLROUND
	INC	HL
	INC	(HL)
	JP	Z,ERRAOV
	LD	L,001H
	CALL	SHIFTRLB
	JP	FLROUND

;
;  Page 105
;

FLADDIFF:
	XOR	A		; FIND DIFFERENCE
	SUB	B
	LD	B,A
	LD	A,(HL)
	SBC	A,E
	LD	E,A
	INC	HL
	LD	A,(HL)
	SBC	A,D
	LD	D,A
	INC	HL
	LD	A,(HL)
	SBC	A,C
	LD	C,A
NORMALZI:
	CALL	C,CMREGS
NORMALIZ:
	LD	L,B		; NORMALIZE REGISTERS
	LD	H,E
	XOR	A
NORMAL8:
	LD	B,A		; NORMALIZE BY BYTES
	LD	A,C
	OR	A
	JP	NZ,NORMAL1
	LD	C,D
	LD	D,H
	LD	H,L
	LD	L,A
	LD	A,B
	SUB	008H
	CP	0E0H
	JP	NZ,NORMAL8
ZEROAC:
	XOR	A		; ZERO ACCUMULATOR
LDACCE:
	LD	(FLACCEXP),A
	RET

NORMAL1L:
	DEC	B		; NORMALIZE BY BITS
	ADD	HL,HL
	LD	A,D
	RLA
	LD	D,A
	LD	A,C
	ADC	A,A
	LD	C,A
NORMAL1:
	JP	P,NORMAL1L
	LD	A,B
	LD	E,H
	LD	B,L
	OR	A

;
;  Page 106
;

	JP	Z,FLROUND
	LD	HL,FLACCEXP
	ADD	A,(HL)
	LD	(HL),A
	JP	NC,ZEROAC
	RET	Z
FLROUND:
	LD	A,B		; ROUND RESULT
FLROUNDV:
	LD	HL,FLACCEXP
	OR	A
	CALL	M,INCCDE
	LD	B,(HL)
	INC	HL
	LD	A,(HL)
	AND	080H
	XOR	C
	LD	C,A
	JP	LDACRG

INCCDE:
	INC	E		; INCREMENT CDE
	RET	NZ
	INC	D
	RET	NZ
	INC	C
	RET	NZ
	LD	C,080H
	INC	(HL)
	RET	NZ
ERRAOV:
	LD	E,ERRNOV-ERRN
	JP	ERRMSG

ADDM2CDE:
	LD	A,(HL)		; ADD MEMORY TO CDE
	ADD	A,E
	LD	E,A
	INC	HL
	LD	A,(HL)
	ADC	A,D
	LD	D,A
	INC	HL
	LD	A,(HL)
	ADC	A,C
	LD	C,A
	RET

;
;  Page 107
;

CMREGS:
	LD	HL,FLACCSSV	; COMPLEMENT SAVED SIGN, CDEB
	LD	A,(HL)
	CPL
	LD	(HL),A
	XOR	A
	LD	L,A
	SUB	B
	LD	B,A
	LD	A,L
	SBC	A,E
	LD	E,A
	LD	A,L
	SBC	A,D
	LD	D,A
	LD	A,L
	SBC	A,C
	LD	C,A
	RET

SHIFTR0:
	LD	B,000H
SHIFTR:
	SUB	008H		; SHIFT CDEB RIGHT BY A BITS
	JP	C,SHIFTRB
	LD	B,E
	LD	E,D
	LD	D,C
	LD	C,000H
	JP	SHIFTR
SHIFTRB:
	ADD	A,009H
	LD	L,A
SHIFTRBL:
	XOR	A
	DEC	L
	RET	Z
	LD	A,C
SHIFTRLB:
	RRA
	LD	C,A
	LD	A,D
	RRA
	LD	D,A
	LD	A,E
	RRA
	LD	E,A
	LD	A,B
	RRA
	LD	B,A
	JP	SHIFTRBL

;
;  Page 108
;

;
;  FLOATING POINT MULTIPLY ROUTINE
;

MULOPR:
	POP	BC
	POP	DE
FLMUL:
	CALL	SIGNACC		; MULTIPLY REGISTERS BY ACC
	RET	Z
	LD	L,000H
	CALL	FLMLDVEX
	LD	A,C
	LD	(FLSCR0),A
	EX	DE,HL
	LD	(FLSCR1),HL
	LD	BC,0
	LD	D,B
	LD	E,C
	LD	HL,NORMALIZ	; NORMALIZE ANSWER AFTER
	PUSH	HL
	LD	HL,FLMULLP	; THREE TIMES THROUGH LOOP
	PUSH	HL
	PUSH	HL
	LD	HL,ACCUMLTR
FLMULLP:
	LD	A,(HL)
	INC	HL
	OR	A
	JP	Z,FLMULXT
	PUSH	HL
	LD	L,008H
FLMULLQ:
	RRA			; NEXT BIT OF MULTIPLIER
	LD	H,A
	LD	A,C
	JP	NC,FLMULNA
	PUSH	HL
	LD	HL,(FLSCR1)	; BIT ON, ADD MULTIPLICAND
	ADD	HL,DE
	EX	DE,HL
	POP	HL
	LD	A,(FLSCR0)
	ADC	A,C
FLMULNA:
	RRA			; SHIFT CDEB RIGHT ONE BIT
	LD	C,A
	LD	A,D
	RRA
	LD	D,A
	LD	A,E
	RRA
	LD	E,A
	LD	A,B
	RRA

;
;  Page 109
;

	LD	B,A
	DEC	L
	LD	A,H
	JP	NZ,FLMULLQ
	POP	HL
	RET

FLMULXT:
	LD	B,E
	LD	E,D
	LD	D,C
	LD	C,A
	RET

FLMLDVEX:
	LD	A,B		; COMPUTE EXP FOR MULTIPLY/DIVIDE
	OR	A
	JP	Z,FLMLDVEZ
	LD	A,L
	LD	HL,FLACCEXP
	XOR	(HL)
	ADD	A,B
	LD	B,A
	RRA
	XOR	B
	LD	A,B
	JP	P,FLMLDVEY
	ADD	A,080H
	LD	(HL),A
	JP	Z,POPHLRET
	CALL	SIGNIFY
	LD	(HL),A
	DEC	HL
	RET

EXPRNEXC:
	CALL	SIGNACC		; RANGE EXECEEDED FOR EXP FUNCTION
	CPL			; RESULT DETERMINED BY SGN(X)
	POP	HL
FLMLDVEY:
	OR	A
FLMLDVEZ:
	POP	HL
	JP	P,ZEROAC
	JP	ERRAOV

;
;  Page 110
;

;
;  FLOATING POINT DIVIDE ROUTINE
;


FLDIVB10:
	CALL	PUSHAC		; COMPUTE AC/10
	LD	BC,08420H
	LD	DE,00000H
	CALL	LDACRG
DIVOPR:
	POP	BC
	POP	DE
FLDIV:
	CALL	SIGNACC		; DIVIDE REGISTERS BY ACCUMULATOR
	JP	Z,ERRAD0
	LD	L,0FFH
	CALL	FLMLDVEX
	INC	(HL)
	INC	(HL)		; Plus 2
	DEC	HL
	LD	A,(HL)
	CPL
	LD	(FLSCR2),A
	DEC	HL
	LD	A,(HL)
	CPL
	LD	(FLSCR1),A
	DEC	HL
	LD	A,(HL)
	CPL
	LD	(FLSCR0),A
	LD	B,C
	EX	DE,HL
	XOR	A
	LD	C,A
	LD	D,A
	LD	E,A
	LD	(FLSCR3),A
FLDIVLP:
	PUSH	HL
	PUSH	BC
	SCF
	LD	A,(FLSCR0)
	ADC	A,L
	LD	L,A
	LD	A,(FLSCR1)
	ADC	A,H
	LD	H,A
	LD	A,(FLSCR2)
	ADC	A,B
	LD	B,A
	LD	A,(FLSCR3)
	ADC	A,0FFH
	JP	NC,FLDIVSF
	LD	(FLSCR3),A

;
;  Page 111
;

	POP	AF		; TRIAL SUBRACT SUCCEEDED,
	POP	AF		; THROW AWAY SAVED DIVIDEND
	SCF
	JP	FLDIVSS
FLDIVSF:
	POP	BC		; TRIAL SUBTRACT FAILED, RESTORE
	POP	HL
FLDIVSS:
	LD	A,C
	INC	A
	DEC	A
	RRA
	JP	M,FLROUNDV
	RLA
	LD	A,E
	RLA
	LD	E,A
	LD	A,D
	RLA
	LD	D,A
	LD	A,C
	RLA
	LD	C,A
	ADD	HL,HL
	LD	A,B
	RLA
	LD	B,A
	LD	A,(FLSCR3)
	RLA
	LD	(FLSCR3),A
	LD	A,C
	OR	D
	OR	E
	JP	NZ,FLDIVLP
	PUSH	HL
	LD	HL,FLACCEXP
	DEC	(HL)
	POP	HL
	JP	NZ,FLDIVLP
	JP	ERRAOV

ERRAD0:
	LD	E,ERRND0-ERRN
	JP	ERRMSG

;
;  Page 112
;

;
;  MISCELLANEOUS AUXILIARY ROUTINES
;


;
;  CPY ACCUMULATOR TO STACK
;
PUSHAC:
	EX	DE,HL		; PUSH ACCUMULATOR ONTO STACK
PUSHAC1:
	LD	HL,(ACCUMLTR)
	EX	(SP),HL
	PUSH	HL
	LD	HL,(FLACCMSB)
	EX	(SP),HL
	PUSH	HL
	EX	DE,HL
	RET

;
;  LOAD ACCUMULATOR
;
LDRGACMM:
	CALL	LDRGMM		; LOAD FLOATING ACC AND REGISTERS
LDACRG:
	EX	DE,HL		; LOAD ACCUMULATOR FROM REGISTERS
	LD	(ACCUMLTR),HL
	LD	H,B
	LD	L,C
	LD	(FLACCMSB),HL
	EX	DE,HL
	RET

;
;  LOAD REGISTERS
;
LDRGAC:
	LD	HL,ACCUMLTR	; LOAD REGISTERS FROM ACCUMULATOR
LDRGMM:
	LD	E,(HL)		; LOAD REGISTERS FROM FLOAT NUMBER
	INC	HL
LDDCBMM:
	LD	D,(HL)		; LOAD REGISTERS FROM STRING
LDICBMM:
	INC	HL
	LD	C,(HL)
	INC	HL
	LD	B,(HL)
INCHLRET:
	INC	HL
	RET

;
;  Page 113
;

;
;  STORE ACCUMULATOR / COPY A VALUE
;
LDMMAC:
	LD	DE,ACCUMLTR	; LOAD MEMORY FROM ACCUMULATOR
COPYVAL:
	LD	A,(TYPEFLG)	; COPY VALUE FROM (DE) TO (HL)
	LD	B,A
COPYVALL:
	LD	A,(DE)
	LD	(HL),A
	INC	DE
	INC	HL
	DEC	B
	JP	NZ,COPYVALL
	RET

;
;  TURN ON HIGH ORDER MANTISSA BITS OF ACCUMULATOR/REGISTERS
;
SIGNIFY:
	LD	HL,FLACCMSB	; SET ON HIGH-ORDER MANTISSA BITS,
	LD	A,(HL)		; AND SAVE SIGN IN FLACCSSV
	RLCA
	SCF
	RRA
	LD	(HL),A		; FIRST ACCUMULATOR,
	CCF
	RRA
	INC	HL
	INC	HL
	LD	(HL),A
	LD	A,C
	RLCA
	SCF
	RRA
	LD	C,A		; THEN REGISTERS
	RRA
	XOR	(HL)
	RET

;
;  Page 114
;

;
;  FLOATING POINT COMPARISON:  REGISTERS VS ACCUMULATOR
;
FLCMP:
	LD	A,B		; FLOATING COMPARE REGS TO ACC
	OR	A
	JP	Z,SIGNACC
	LD	HL,FLCMPXT
	PUSH	HL
	CALL	SIGNACC
	LD	A,C
	RET	Z
	LD	HL,FLACCMSB
	XOR	(HL)
	LD	A,C
	RET	M
	CALL	FLCMPM
	RRA
	XOR	C
	RET

FLCMPM:
	INC	HL		; COMPARE MANTISSAS
	LD	A,B
	CP	(HL)
	RET	NZ
	DEC	HL
	LD	A,C
	CP	(HL)
	RET	NZ
	DEC	HL
	LD	A,D
	CP	(HL)
	RET	NZ
	DEC	HL
	LD	A,E
	SUB	(HL)
	RET	NZ
	POP	HL
	POP	HL
	RET

;
;  Page 115
;

;
;  COMPUTER INTEGER PART OF ACCUMULATOR
;
FIXAC:
	LD	B,A		; LOAD REGS WITH FIX(AC)
	LD	C,A
	LD	D,A
	LD	E,A
	OR	A
	RET	Z
	PUSH	HL
	CALL	LDRGAC
	CALL	SIGNIFY
	XOR	(HL)
	LD	H,A
	CALL	M,DECCDE
	LD	A,098H
	SUB	B
	CALL	SHIFTR0
	LD	A,H
	RLA
	CALL	C,INCCDE
	LD	B,000H
	CALL	C,CMREGS
	POP	HL
	RET

DECCDE:
	DEC	DE		; DECREMENT CDE
	LD	A,D
	AND	E
	INC	A
	RET	NZ
	DEC	C
	RET

FLMULB10:
	CALL	LDRGAC		; MULTIPLY CONTENTS OF AC BY 10
	LD	A,B
	OR	A
	RET	Z
	ADD	A,002H
	JP	C,ERRAOV
	LD	B,A
	CALL	FLADD		; AC=AC+4*AC
	LD	HL,FLACCEXP
	INC	(HL)		; AC=2*AC
	RET	NZ
	JP	ERRAOV

SIGNACC:
	LD	A,(FLACCEXP)	; FIND SIGN OF ACCUMULATOR
	OR	A
	RET	Z
	LD	A,(FLACCMSB)

;
;  Page 116
;

	JP	SIGNXTND
FLCMPXT:
	CPL
SIGNXTND:
	RLA
CMPXT:
	SBC	A,A
	RET	NZ
	INC	A
	RET

CMANSWR:
	LD	HL,CMACCS	; F(X)=-F(0)
	EX	(SP),HL
	JP	(HL)

SGNFCT:
	CALL	SIGNACC
FLOATBYT:
	LD	B,088H
	LD	DE,0
FLOATINT:
	LD	HL,FLACCEXP	; CONVERT INTEGER IN ADE TO FLOAT,
	LD	C,A
	LD	(HL),B		; EXPONENT ASSUMED IN B
	LD	B,000H
	INC	HL
	LD	(HL),080H
	RLA
	JP	NORMALZI

;
;  COMPUTE ABSOLUTE VALUE OF ACCUMULATOR
;
ABSFCT:
	CALL	SIGNACC		; ABS FUNCTION
	RET	P
CMACCS:
	LD	HL,FLACCMSB	; CHANGE SIGN OF ACCUMULATOR
	LD	A,(HL)
	XOR	080H
	LD	(HL),A
	RET

INTFCT:
	LD	HL,FLACCEXP	; INT FUNCTION
	LD	A,(HL)
	CP	098H
	LD	A,(ACCUMLTR)
	RET	NC
	LD	A,(HL)
	CALL	FIXAC
	LD	(HL),098H
	LD	A,E
	PUSH	AF
	LD	A,C

;
;  Page 117
;

	RLA
	CALL	NORMALZI
	POP	AF
	RET

;
;  Page 118
;

;
;  FLOATING POINT DECODE ROUTINE
;


DECODE:
	CP	'-'		; DECODE EXTERNAL FORM OF NUMBER
	PUSH	AF
	JP	Z,DECODEIN
	CP	'+'
	JP	Z,DECODEIN
	DEC	HL
DECODEIN:
	CALL	ZEROAC
	LD	B,A
	LD	D,A
	LD	E,A
	CPL
	LD	C,A
DECODELP:
	CALL	SCANNXT		; Bscan ,
	JP	C,DECDIGIT
	CP	'.'
	JP	Z,DECODEPT
	CP	'E'		; UPPER CASE E
	JP	Z,DECODEXP
	CP	'e'		; LOWER CASE E
	JP	NZ,DECODVAL
DECODEXP:
	CALL	SCANNXT		; Bscan ,
	PUSH	HL
	LD	HL,DECODEXL
	EX	(SP),HL
	DEC	D
	CP	KEYSUB
	RET	Z
	CP	'-'
	RET	Z
	INC	D
	CP	'+'
	RET	Z
	CP	KEYADD
	RET	Z
	POP	AF
	DEC	HL
DECODEXL:
	CALL	SCANNXT		; Bscan ,  ;SCAN EXPONENT
	JP	NC,DECODEXQ
	LD	A,E		; DECODE EXPONENT DIGIT
	RLCA			; E=10*E+VAL(M)
	RLCA
	ADD	A,E
	RLCA
	ADD	A,(HL)
	SUB	'0'
	LD	E,A

;
;  Page 119
;

	JP	DECODEXL
DECODEXQ:
	INC	D
	JP	NZ,DECODVAL
	XOR	A
	SUB	E
	LD	E,A
	INC	C
DECODEPT:
	INC	C		; DECODE DECIMAL POINT
	JP	Z,DECODELP
DECODVAL:
	PUSH	HL
	LD	A,E
	SUB	B
DECDEXPA:
	CALL	P,DECMULUP	; COMBINE MANTISSA, EXPONENT
	JP	P,DECDEXAL
	PUSH	AF
	CALL	FLDIVB10
	POP	AF
	INC	A
DECDEXAL:
	JP	NZ,DECDEXPA
	POP	DE
	POP	AF
	CALL	Z,CMACCS
	EX	DE,HL
	RET

;
;  Page 120
;

DECMULUP:
	RET	Z
FLMLB10C:
	PUSH	AF
	CALL	FLMULB10
	POP	AF
	DEC	A
	RET

DECDIGIT:
	PUSH	DE		; DECODE DIGIT OF NUMBER
	LD	D,A
	LD	A,B
	ADC	A,C
	LD	B,A
	PUSH	BC
	PUSH	HL
	PUSH	DE
	CALL	FLMULB10
	POP	AF
	SUB	'0'
	CALL	DECDGADD
	POP	HL
	POP	BC
	POP	DE
	JP	DECODELP

DECDGADD:
	CALL	PUSHAC
	CALL	FLOATBYT
ADDOPR:
	POP	BC
	POP	DE
	JP	FLADD

;
;  Page 121
;

;
;  FLOATING POINT ENCODE ROUTINE
;
ERRMSGIN:
	PUSH	HL		; PRINT CUR LINE NUMBER IN ERROR
	LD	HL,MSGIN
	CALL	PRNTMSG
	POP	HL
PRINTINT:
	PUSH	HL		; PRINT AN INTEGER
	LD	HL,PRNTNUMS
	EX	(SP),HL
ENCODEHL:
	EX	DE,HL		; ENCODE AN INTEGER
	XOR	A
	LD	B,098H
	CALL	FLOATINT
ENCODE:
	LD	DE,-13		; ENCODE AC IN EXTERNAL FORM
	LD	HL,(PROGBASE)
	ADD	HL,DE		; CREATE POINTER TO ENCODE BUFFER
	PUSH	HL
	CALL	SIGNACC
	LD	(HL),' '
	JP	P,ENCODFRS
	LD	(HL),'-'
ENCODFRS:
	INC	HL
	LD	(HL),'0'
	JP	Z,ENCODZXT
	PUSH	HL
	CALL	M,CMACCS
	XOR	A
	PUSH	AF
	CALL	ENCODCMP
ENCODUPL:
	LD	BC,09143H	; FORCE NUMBER TO RANGE
	LD	DE,04FF8H	; 10**5 <= AC BY MULTIPLICATION
	CALL	FLCMP
	DEC	A
	JP	P,ENCODRND
	POP	AF
	CALL	FLMLB10C
	PUSH	AF
	JP	ENCODUPL

ENCODDNL:
	CALL	FLDIVB10	; FORCE NUMBER TO RANGE
	POP	AF		; AC < 10**6 BY DIVISION
	INC	A
	PUSH	AF
	CALL	ENCODCMP
ENCODRND:
	CALL	FLADDHLF	; ROUND UP RESULT
	INC	A

;
;  Page 122
;

	CALL	FIXAC
	CALL	LDACRG
	LD	BC,00206H	; D.DDDDD
	POP	AF
	ADD	A,C
	JP	M,ENCDEXPS
	CP	007H
	JP	NC,ENCDEXPS
	INC	A
	LD	B,A
	LD	A,001H
ENCDEXPS:
	DEC	A
	POP	HL
	PUSH	AF
	LD	DE,ENCDCOEF
ENCODDGL:
	DEC	B
	LD	(HL),'.'
	CALL	Z,INCHLRET
	PUSH	BC
	PUSH	HL
	PUSH	DE
	CALL	LDRGAC
	POP	HL
	LD	B,'0'-1		; GENERATE NEXT DIGIT
ENCODSBL:
	INC	B
	LD	A,E
	SUB	(HL)
	LD	E,A
	INC	HL
	LD	A,D
	SBC	A,(HL)
	LD	D,A
	INC	HL
	LD	A,C
	SBC	A,(HL)
	LD	C,A
	DEC	HL
	DEC	HL
	JP	NC,ENCODSBL
	CALL	ADDM2CDE
	INC	HL
	CALL	LDACRG
	EX	DE,HL
	POP	HL
	LD	(HL),B
	INC	HL
	POP	BC
	DEC	C
	JP	NZ,ENCODDGL
	DEC	B
	JP	Z,ENCODEXP
ENCDRTZR:
	DEC	HL		; REMOVE TRAILING ZEROES

;
;  Page 123
;

	LD	A,(HL)
	CP	'0'
	JP	Z,ENCDRTZR
	CP	'.'		; REMOVE TRAILING DECIMAL POINT
	CALL	NZ,INCHLRET
ENCODEXP:
	POP	AF		; ENCODE EXPONENT
	JP	Z,ENCODEXT
	LD	(HL),'E'
	INC	HL
	LD	(HL),'+'
	JP	P,ENCDEXPP
	LD	(HL),'-'
	CPL
	INC	A
ENCDEXPP:
	LD	B,'0'-1
ENCDEXPL:
	INC	B
	SUB	10
	JP	NC,ENCDEXPL
	ADD	A,'9'+1
	INC	HL
	LD	(HL),B
ENCODZXT:
	INC	HL
	LD	(HL),A
	INC	HL
ENCODEXT:
	LD	(HL),C
	POP	HL
	RET

ENCODCMP:
	LD	BC,09474H	; 10**6
	LD	DE,023F7H
	CALL	FLCMP
	POP	HL
	DEC	A
	JP	P,ENCODDNL
	JP	(HL)

FLHALF:
	DEFB	000H, 000H, 000H, 080H ; 1/2

ENCDCOEF:
	DEFB	0A0H, 086H, 001H ; 10**5
	DEFB	010H, 027H, 000H ; 10**4
	DEFB	0E8H, 003H, 000H ; 10**3
	DEFB	064H, 000H, 000H ; 10**2
	DEFB	00AH, 000H, 000H ; 10**1
	DEFB	001H, 000H, 000H ; 10**0

;
;  Page 124
;

;
;  FLOATING POINT LOGARITHM ROUTINE
;

LOGCOEF:
	DEFB	3
	DEFB	0AAH, 056H, 019H, 080H
	DEFB	0F1H, 022H, 076H, 080H
	DEFB	045H, 0AAH, 038H, 082H
FLONE:
	DEFB	000H, 000H, 000H, 081H ; 1.0
LOGFCT:
	CALL	SIGNACC		; LOG FUNCTION
	DEC	A
	JP	M,ERRAFC
	LD	HL,FLACCEXP
	LD	A,(HL)
	LD	BC,08035H
	LD	DE,004F3H
	SUB	B
	PUSH	AF
	LD	(HL),B
	PUSH	DE
	PUSH	BC
	CALL	FLADD
	POP	BC
	POP	DE
	INC	B
	CALL	FLDIV
	LD	HL,FLONE
	CALL	FLMMMAC
	LD	HL,LOGCOEF
	CALL	FCTPOLY2
	LD	BC,08080H
	LD	DE,00000H
	CALL	FLADD
	POP	AF
	CALL	DECDGADD
FLMULLN2:
	LD	BC,08031H	; LN(2)=0.6931472
	LD	DE,07218H
	JP	FLMUL

;
;  Page 125
;

;
;  FLOATING POINT SQUARE ROOT/EXPONENTIATION ROUTINE
;

SQRFCT:
	CALL	PUSHAC		; SQR FUNCTION
	LD	HL,FLHALF	; SQR(X)=X**1/2
	CALL	LDRGACMM
EXPOPR:
	POP	BC		; X**Y=EXP(LOG(X)*Y)
	POP	DE
	CALL	SIGNACC
	JP	Z,EXPFCT
	LD	A,B
	OR	A
	JP	Z,LDACCE
	PUSH	DE
	PUSH	BC
	LD	A,C
	OR	07FH
	CALL	LDRGAC
	JP	P,EXPEXPOS
	PUSH	DE
	PUSH	BC
	CALL	INTFCT
	POP	BC
	POP	DE
	PUSH	AF
	CALL	FLCMP
	POP	HL
	LD	A,H
	RRA
EXPEXPOS:
	POP	HL
	LD	(FLACCMSB),HL
	POP	HL
	LD	(ACCUMLTR),HL
	CALL	C,CMANSWR
	CALL	Z,CMACCS
	PUSH	DE
	PUSH	BC
	CALL	LOGFCT
	POP	BC
	POP	DE
	CALL	FLMUL

;
;  Page 126
;

;
;  EXPONENTIAL FUNCTION ROUTINE
;


EXPFCT:
	CALL	PUSHAC		; EXP FUNCTION
	LD	BC,08138H	; LOG(2)E=1.442695
	LD	DE,0AA3BH
	CALL	FLMUL
	LD	A,(FLACCEXP)
	CP	088H
	JP	NC,EXPRNEXC
	CALL	INTFCT
	ADD	A,080H
	ADD	A,002H
	JP	C,EXPRNEXC
	PUSH	AF
	LD	HL,FLONE
	CALL	FLADDM
	CALL	FLMULLN2
	POP	AF
	POP	BC
	POP	DE
	PUSH	AF
	CALL	FLSUB
	CALL	CMACCS
	LD	HL,EXPCOEF
	CALL	FCTPOLY1
	LD	DE,0
	POP	BC
	LD	C,D
	JP	FLMUL

EXPCOEF:
	DEFB	8
	DEFB	040H, 02EH, 094H, 074H
	DEFB	070H, 04FH, 02EH, 077H
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	DEFB	000H, 000H, 000H, 081H

;
;  Page 127
;

;
;  FLOATING POINT POLYNOMINAL EVALUATORS
;


FCTPOLY2:
	CALL	PUSHAC		; POLYNOMIAL EVALUATOR
	LD	DE,MULOPR	; EVALUATE P(X**2)*X
	PUSH	DE
	PUSH	HL
	CALL	LDRGAC
	CALL	FLMUL
	POP	HL
FCTPOLY1:
	CALL	PUSHAC		; EVALUATE P(X)
	LD	A,(HL)
	INC	HL
	CALL	LDRGACMM
FCTPOLYL:
	POP	BC
	POP	DE
	DEC	A
	RET	Z
	PUSH	DE
	PUSH	BC
	PUSH	AF
	PUSH	HL
	CALL	FLMUL
	POP	HL
	CALL	LDRGMM
	PUSH	HL
	CALL	FLADD
	POP	HL
	POP	AF
	JP	FCTPOLYL

;
;  Page 128
;

;
;  RANDOM NUMBER GENERATOR
;


RNDFCT:
	CALL	SIGNACC		; RND FUNCTION
	JP	M,RNDFCTUS	; <0 - INITIALIZE SEED
	LD	HL,RNDFCTSD
	CALL	LDRGACMM
	RET	Z		; =0 - PREVIOUS VALUE
	LD	BC,09835H
	LD	DE,0447AH
	CALL	FLMUL		; >0 - NEXT VALUE
	LD	BC,06828H
	LD	DE,0B146H
	CALL	FLADD
RNDFCTUS:
	CALL	LDRGAC		; CHANGE SEED
	LD	A,E
	LD	E,C
	LD	C,A
	LD	(HL),080H
	DEC	HL
	LD	B,(HL)
	LD	(HL),080H
	CALL	NORMALIZ
	LD	HL,RNDFCTSD
	JP	LDMMAC

;
;  Page 129
;

;
;  FLOATING POINT SINE/COSINE ROUTINES
;


COSFCT:
	LD	HL,PIOVER2	; COS FUNCTION
	CALL	FLADDM
SINFCT:
	CALL	PUSHAC		; SIN FUNCTION
	LD	BC,08349H	; Y=X*2*PI
	LD	DE,00FDBH
	CALL	LDACRG
	POP	BC
	POP	DE
	CALL	FLDIV
	CALL	PUSHAC		; Y=Y MOD 1
	CALL	INTFCT
	POP	BC
	POP	DE
	CALL	FLSUB
	LD	HL,FLQUART
	CALL	FLMMMAC
	CALL	SIGNACC
	SCF
	JP	P,SINFCTC
	CALL	FLADDHLF
	CALL	SIGNACC
	OR	A
SINFCTC:
	PUSH	AF
	CALL	P,CMACCS
	LD	HL,FLQUART
	CALL	FLADDM
	POP	AF
	CALL	NC,CMACCS
	LD	HL,COSCOEF
	JP	FCTPOLY2

PIOVER2:
	DEFB	0DBH, 00FH, 049H, 081H ; PI/2


FLQUART:
	DEFB	000H, 000H, 000H, 07FH ; 1/4

COSCOEF:
	DEFB	5
	DEFB	0BAH, 0D7H, 01EH, 086H
	DEFB	064H, 026H, 099H, 087H
	DEFB	058H, 034H, 023H, 087H
	DEFB	0E0H, 05DH, 0A5H, 086H

;
;  Page 130
;

	DEFB	0DAH, 00FH, 049H, 083H

;
;  Page 131
;

;
;  FLOATING POINT TANGENT/ARCTANGENT ROUTINES
;


TANFCT:
	CALL	PUSHAC		; TAN FUNCTION
	CALL	SINFCT
	POP	BC		; TAN(X) = SIN(X)/COS(X)
	POP	HL
	CALL	PUSHAC
	EX	DE,HL
	CALL	LDACRG
	CALL	COSFCT
	JP	DIVOPR

ATNFCT:
	CALL	SIGNACC
	CALL	M,CMANSWR
	CALL	M,CMACCS
	LD	A,(FLACCEXP)
	CP	081H
	JP	C,ATNFCTC
	LD	BC,08100H
	LD	D,C
	LD	E,C
	CALL	FLDIV
	LD	HL,FLMMMAC
	PUSH	HL
ATNFCTC:
	LD	HL,ATNCOEF
	CALL	FCTPOLY2
	LD	HL,PIOVER2
	RET

ATNCOEF:
	DEFB	9
	DEFB	04AH, 0D7H, 03BH, 078H
	DEFB	002H, 06EH, 084H, 07BH
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	DEFB	000H, 000H, 000H, 081H

;
;  Page 132
;

VERSNDAT:
	DEFB	'02/03/78',0


ENDINTRP:
	DEFB	0		; END OF INTERPRETER

;
;  Page 133
;

;
;  INITIALIZATION
;

INITIALZ:

	LD	HL,0FFFFH
	LD	(CURLINE),HL
	LD	HL,INITSTCK
	LD	SP,HL
	LD	(STCKBASE),HL
	XOR	A
	LD	(PRINTFLG),A
	CALL	DCLR
	CALL	PRNTCRLF
	LD	HL,LIMUPPER	; ADDRESS LAST BYTE
	LD	(STRGTLIM),HL
	LD	DE,-10*3
	ADD	HL,DE
	LD	(STRGBASE),HL
	LD	(STRGFREE),HL
	LD	DE,-256
	ADD	HL,DE
	JP	NC,ERRAOM
	PUSH	HL
	LD	HL,LIMLOWER	; ADDRESS OF FIRST BYTE
	LD	DE,12
	ADD	HL,DE
	LD	(HL),000H
	INC	HL
	LD	(PROGBASE),HL
	EX	(SP),HL
	POP	DE
	LD	SP,HL
	LD	(STCKBASE),HL
	LD	HL,-13
	ADD	HL,SP
	LD	SP,HL
	EX	DE,HL
	CALL	SPACECHK
	LD	A,E
	SUB	L
	LD	L,A
	LD	A,D
	SBC	A,H
	LD	H,A
	LD	BC,-16
	ADD	HL,BC
	CALL	PRNTCRLF
	CALL	PRINTINT
	LD	HL,INITMFRE
	CALL	PRNTMSG
	LD	HL,VERSNDAT
	CALL	PRNTMSG
	CALL	CLEARPGM
	LD	HL,CMNDRSTR

;
;  Page 134
;

	LD	(SYSINITJ+1),HL
	JP	(HL)


INITMFRE:
	DEFB	' BYTES FREE'
	DEFB	CR,LF,LF
	DEFB	'BASIC, Version of ', 0
INITSTSP:
	DEFS	30*2+LINESYZE	; INITIALIZE STACK SPACE
INITSTCK:
	DEFS	20



	END